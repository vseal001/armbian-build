/dts-v1/;
// version: 17
// last_comp_version: 16
// boot_cpuid_phys: 0x0

/memreserve/ 0x4600000 0x15000;
/memreserve/ 0x4bf0000 0x258028;
/ {
    compatible = "rockchip,rk3399-kc2", "rockchip,rk3399";
    interrupt-parent = <0x1>;
    #address-cells = <0x2>;
    #size-cells = <0x2>;
    memory {
        reg = <0x0 0x200000 0x0 0x8200000 0x0 0xA200000 0x0 0xEDE00000>;
        device_type = "memory";
    };
    ddr_timing {
        compatible = "rockchip,ddr-timing";
        ddr3_speed_bin = <0x15>;
        pd_idle = <0x0>;
        sr_idle = <0x0>;
        sr_mc_gate_idle = <0x0>;
        srpd_lite_idle = <0x0>;
        standby_idle = <0x0>;
        auto_lp_dis_freq = <0x29A>;
        ddr3_dll_dis_freq = <0x12C>;
        phy_dll_dis_freq = <0x104>;
        ddr3_odt_dis_freq = <0x29A>;
        ddr3_drv = <0x28>;
        ddr3_odt = <0x78>;
        phy_ddr3_ca_drv = <0x28>;
        phy_ddr3_dq_drv = <0x28>;
        phy_ddr3_odt = <0xF0>;
        lpddr3_odt_dis_freq = <0x29A>;
        lpddr3_drv = <0x22>;
        lpddr3_odt = <0xF0>;
        phy_lpddr3_ca_drv = <0x22>;
        phy_lpddr3_dq_drv = <0x22>;
        phy_lpddr3_odt = <0xF0>;
        lpddr4_odt_dis_freq = <0x320>;
        lpddr4_drv = <0xF0>;
        lpddr4_dq_odt = <0x28>;
        lpddr4_ca_odt = <0x0>;
        phy_lpddr4_ca_drv = <0x28>;
        phy_lpddr4_ck_cs_drv = <0x28>;
        phy_lpddr4_dq_drv = <0x3C>;
        phy_lpddr4_odt = <0x28>;
        phandle = <0x94>;
    };
    aliases {
        i2c0 = "/i2c@ff3c0000";
        i2c1 = "/i2c@ff110000";
        i2c2 = "/i2c@ff120000";
        i2c3 = "/i2c@ff130000";
        i2c4 = "/i2c@ff3d0000";
        i2c5 = "/i2c@ff140000";
        i2c6 = "/i2c@ff150000";
        i2c7 = "/i2c@ff160000";
        i2c8 = "/i2c@ff3e0000";
        serial0 = "/serial@ff180000";
        serial1 = "/serial@ff190000";
        serial2 = "/serial@ff1a0000";
        serial3 = "/serial@ff1b0000";
        serial4 = "/serial@ff370000";
        dsi0 = "/dsi@ff960000";
        dsi1 = "/dsi@ff968000";
    };
    cpus {
        #address-cells = <0x2>;
        #size-cells = <0x0>;
        cpu-map {
            cluster0 {
                core0 {
                    cpu = <0x2>;
                };
                core1 {
                    cpu = <0x3>;
                };
                core2 {
                    cpu = <0x4>;
                };
                core3 {
                    cpu = <0x5>;
                };
            };
            cluster1 {
                core0 {
                    cpu = <0x6>;
                };
                core1 {
                    cpu = <0x7>;
                };
            };
        };
        cpu@0 {
            device_type = "cpu";
            compatible = "arm,cortex-a53", "arm,armv8";
            reg = <0x0 0x0>;
            enable-method = "psci";
            #cooling-cells = <0x2>;
            clocks = <0x8 0x8>;
            cpu-idle-states = <0x9 0xA>;
            dynamic-power-coefficient = <0x64>;
            operating-points-v2 = <0xB>;
            sched-energy-costs = <0xC 0xD>;
            cpu-supply = <0xE>;
            phandle = <0x2>;
        };
        cpu@1 {
            device_type = "cpu";
            compatible = "arm,cortex-a53", "arm,armv8";
            reg = <0x0 0x1>;
            enable-method = "psci";
            clocks = <0x8 0x8>;
            cpu-idle-states = <0x9 0xA>;
            dynamic-power-coefficient = <0x64>;
            operating-points-v2 = <0xB>;
            sched-energy-costs = <0xC 0xD>;
            cpu-supply = <0xE>;
            phandle = <0x3>;
        };
        cpu@2 {
            device_type = "cpu";
            compatible = "arm,cortex-a53", "arm,armv8";
            reg = <0x0 0x2>;
            enable-method = "psci";
            clocks = <0x8 0x8>;
            cpu-idle-states = <0x9 0xA>;
            dynamic-power-coefficient = <0x64>;
            operating-points-v2 = <0xB>;
            sched-energy-costs = <0xC 0xD>;
            cpu-supply = <0xE>;
            phandle = <0x4>;
        };
        cpu@3 {
            device_type = "cpu";
            compatible = "arm,cortex-a53", "arm,armv8";
            reg = <0x0 0x3>;
            enable-method = "psci";
            clocks = <0x8 0x8>;
            cpu-idle-states = <0x9 0xA>;
            dynamic-power-coefficient = <0x64>;
            operating-points-v2 = <0xB>;
            sched-energy-costs = <0xC 0xD>;
            cpu-supply = <0xE>;
            phandle = <0x5>;
        };
        cpu@100 {
            device_type = "cpu";
            compatible = "arm,cortex-a72", "arm,armv8";
            reg = <0x0 0x100>;
            enable-method = "psci";
            #cooling-cells = <0x2>;
            clocks = <0x8 0x9>;
            cpu-idle-states = <0x9 0xA>;
            dynamic-power-coefficient = <0x1B4>;
            operating-points-v2 = <0xF>;
            sched-energy-costs = <0x10 0x11>;
            cpu-supply = <0x12>;
            phandle = <0x6>;
        };
        cpu@101 {
            device_type = "cpu";
            compatible = "arm,cortex-a72", "arm,armv8";
            reg = <0x0 0x101>;
            enable-method = "psci";
            clocks = <0x8 0x9>;
            cpu-idle-states = <0x9 0xA>;
            dynamic-power-coefficient = <0x1B4>;
            operating-points-v2 = <0xF>;
            sched-energy-costs = <0x10 0x11>;
            cpu-supply = <0x12>;
            phandle = <0x7>;
        };
        idle-states {
            entry-method = "psci";
            cpu-sleep {
                compatible = "arm,idle-state";
                local-timer-stop;
                arm,psci-suspend-param = <0x10000>;
                entry-latency-us = <0x78>;
                exit-latency-us = <0xFA>;
                min-residency-us = <0x384>;
                phandle = <0x9>;
            };
            cluster-sleep {
                compatible = "arm,idle-state";
                local-timer-stop;
                arm,psci-suspend-param = <0x1010000>;
                entry-latency-us = <0x190>;
                exit-latency-us = <0x1F4>;
                min-residency-us = <0x7D0>;
                phandle = <0xA>;
            };
        };
    };
    pmu_a53 {
        compatible = "arm,cortex-a53-pmu";
        interrupts = <0x1 0x7 0x8 0x13>;
    };
    pmu_a72 {
        compatible = "arm,cortex-a72-pmu";
        interrupts = <0x1 0x7 0x8 0x14>;
    };
    psci {
        compatible = "arm,psci-1.0";
        method = "smc";
    };
    timer {
        compatible = "arm,armv8-timer";
        interrupts = <0x1 0xD 0x8 0x0 0x1 0xE 0x8 0x0 0x1 0xB 0x8 0x0 0x1 0xA 0x8 0x0>;
    };
    xin24m {
        compatible = "fixed-clock";
        clock-frequency = <0x16E3600>;
        clock-output-names = "xin24m";
        #clock-cells = <0x0>;
    };
    dummy_cpll {
        compatible = "fixed-clock";
        clock-frequency = <0x0>;
        clock-output-names = "dummy_cpll";
        #clock-cells = <0x0>;
    };
    dummy_vpll {
        compatible = "fixed-clock";
        clock-frequency = <0x0>;
        clock-output-names = "dummy_vpll";
        #clock-cells = <0x0>;
    };
    amba {
        compatible = "arm,amba-bus";
        #address-cells = <0x2>;
        #size-cells = <0x2>;
        ranges;
        dma-controller@ff6d0000 {
            compatible = "arm,pl330", "arm,primecell";
            reg = <0x0 0xFF6D0000 0x0 0x4000>;
            interrupts = <0x0 0x5 0x4 0x0 0x0 0x6 0x4 0x0>;
            #dma-cells = <0x1>;
            clocks = <0x8 0xD3>;
            clock-names = "apb_pclk";
            peripherals-req-type-burst;
            phandle = <0x5B>;
        };
        dma-controller@ff6e0000 {
            compatible = "arm,pl330", "arm,primecell";
            reg = <0x0 0xFF6E0000 0x0 0x4000>;
            interrupts = <0x0 0x7 0x4 0x0 0x0 0x8 0x4 0x0>;
            #dma-cells = <0x1>;
            clocks = <0x8 0xD4>;
            clock-names = "apb_pclk";
            peripherals-req-type-burst;
            phandle = <0x48>;
        };
    };
    ethernet@fe300000 {
        compatible = "rockchip,rk3399-gmac";
        reg = <0x0 0xFE300000 0x0 0x10000>;
        rockchip,grf = <0x15>;
        interrupts = <0x0 0xC 0x4 0x0>;
        interrupt-names = "macirq";
        clocks = <0x8 0x69 0x8 0x67 0x8 0x68 0x8 0x66 0x8 0x6A 0x8 0xD5 0x8 0x166>;
        clock-names = "stmmaceth", "mac_clk_rx", "mac_clk_tx", "clk_mac_ref", "clk_mac_refout", "aclk_mac", "pclk_mac";
        resets = <0x8 0x89>;
        reset-names = "stmmaceth";
        power-domains = <0x16 0x16>;
        status = "okay";
        phy-supply = <0x17>;
        phy-mode = "rgmii";
        clock_in_out = "input";
        snps,reset-gpio = <0x18 0xF 0x1>;
        snps,reset-active-low;
        snps,reset-delays-us = <0x0 0x2710 0xC350>;
        assigned-clocks = <0x8 0xA6>;
        assigned-clock-parents = <0x19>;
        pinctrl-names = "default";
        pinctrl-0 = <0x1A>;
        rx_delay = <0x11>;
    };
    dwmmc@fe310000 {
        compatible = "rockchip,rk3399-dw-mshc", "rockchip,rk3288-dw-mshc";
        reg = <0x0 0xFE310000 0x0 0x4000>;
        interrupts = <0x0 0x40 0x4 0x0>;
        clock-freq-min-max = <0x30D40 0x8F0D180>;
        clocks = <0x8 0x1EE 0x8 0x4D 0x8 0x9C 0x8 0x9D>;
        clock-names = "biu", "ciu", "ciu-drive", "ciu-sample";
        fifo-depth = <0x100>;
        power-domains = <0x16 0x1C>;
        status = "okay";
        clock-frequency = <0x8F0D180>;
        supports-sdio;
        bus-width = <0x4>;
        disable-wp;
        cap-sd-highspeed;
        cap-sdio-irq;
        keep-power-in-suspend;
        mmc-pwrseq = <0x1B>;
        non-removable;
        num-slots = <0x1>;
        pinctrl-names = "default";
        pinctrl-0 = <0x1C 0x1D 0x1E>;
        sd-uhs-sdr104;
    };
    dwmmc@fe320000 {
        compatible = "rockchip,rk3399-dw-mshc", "rockchip,rk3288-dw-mshc";
        reg = <0x0 0xFE320000 0x0 0x4000>;
        interrupts = <0x0 0x41 0x4 0x0>;
        clock-freq-min-max = <0x61A80 0x8F0D180>;
        clocks = <0x8 0x1CE 0x8 0x4C 0x8 0x9A 0x8 0x9B>;
        clock-names = "biu", "ciu", "ciu-drive", "ciu-sample";
        fifo-depth = <0x100>;
        power-domains = <0x16 0x1B>;
        status = "okay";
        clock-frequency = <0x2FAF080>;
        supports-sd;
        bus-width = <0x4>;
        cap-mmc-highspeed;
        cap-sd-highspeed;
        disable-wp;
        num-slots = <0x1>;
        vqmmc-supply = <0x1F>;
        pinctrl-names = "default";
        pinctrl-0 = <0x20 0x21 0x22 0x23>;
    };
    sdhci@fe330000 {
        compatible = "rockchip,rk3399-sdhci-5.1", "arasan,sdhci-5.1";
        reg = <0x0 0xFE330000 0x0 0x10000>;
        interrupts = <0x0 0xB 0x4 0x0>;
        arasan,soc-ctl-syscon = <0x15>;
        assigned-clocks = <0x8 0x4E>;
        assigned-clock-rates = <0xBEBC200>;
        clocks = <0x8 0x4E 0x8 0xF0>;
        clock-names = "clk_xin", "clk_ahb";
        clock-output-names = "emmc_cardclock";
        #clock-cells = <0x0>;
        phys = <0x24>;
        phy-names = "phy_arasan";
        power-domains = <0x16 0x17>;
        status = "okay";
        assigned-clock-parents = <0x8 0x5>;
        bus-width = <0x8>;
        mmc-hs400-1_8v;
        supports-emmc;
        non-removable;
        keep-power-in-suspend;
        mmc-hs400-enhanced-strobe;
        phandle = <0x9D>;
    };
    usb@fe340000 {
        compatible = "generic-ehci";
        reg = <0x0 0xFE340000 0x0 0x30000>;
        interrupts = <0x0 0x21 0x4 0x0>;
        clocks = <0x8 0x1CC 0x8 0x79 0x8 0x154>;
        clock-names = "hclk_hsic", "clk_hsicphy", "pclk_hsicphy";
        rockchip-has-usic;
        status = "disabled";
    };
    usb@fe380000 {
        compatible = "generic-ehci";
        reg = <0x0 0xFE380000 0x0 0x20000>;
        interrupts = <0x0 0x1A 0x4 0x0>;
        clocks = <0x8 0x1C8 0x8 0x1C9 0x8 0xA8>;
        clock-names = "hclk_host0", "hclk_host0_arb", "usbphy0_480m";
        phys = <0x25>;
        phy-names = "usb";
        power-domains = <0x16 0xE>;
        status = "okay";
    };
    usb@fe3a0000 {
        compatible = "generic-ohci";
        reg = <0x0 0xFE3A0000 0x0 0x20000>;
        interrupts = <0x0 0x1C 0x4 0x0>;
        clocks = <0x8 0x1C8 0x8 0x1C9 0x8 0xA8>;
        clock-names = "hclk_host0", "hclk_host0_arb", "usbphy0_480m";
        phys = <0x25>;
        phy-names = "usb";
        power-domains = <0x16 0xE>;
        status = "okay";
    };
    usb@fe3c0000 {
        compatible = "generic-ehci";
        reg = <0x0 0xFE3C0000 0x0 0x20000>;
        interrupts = <0x0 0x1E 0x4 0x0>;
        clocks = <0x8 0x1CA 0x8 0x1CB 0x8 0xA9>;
        clock-names = "hclk_host1", "hclk_host1_arb", "usbphy1_480m";
        phys = <0x26>;
        phy-names = "usb";
        power-domains = <0x16 0xE>;
        status = "okay";
    };
    usb@fe3e0000 {
        compatible = "generic-ohci";
        reg = <0x0 0xFE3E0000 0x0 0x20000>;
        interrupts = <0x0 0x20 0x4 0x0>;
        clocks = <0x8 0x1CA 0x8 0x1CB 0x8 0xA9>;
        clock-names = "hclk_host1", "hclk_host1_arb", "usbphy1_480m";
        phys = <0x26>;
        phy-names = "usb";
        power-domains = <0x16 0xE>;
        status = "okay";
    };
    usb@fe800000 {
        compatible = "rockchip,rk3399-dwc3";
        clocks = <0x8 0x81 0x8 0x83 0x8 0xF6 0x8 0xF9>;
        clock-names = "ref_clk", "suspend_clk", "bus_clk", "grf_clk";
        power-domains = <0x16 0x18>;
        resets = <0x8 0x125>;
        reset-names = "usb3-otg";
        #address-cells = <0x2>;
        #size-cells = <0x2>;
        ranges;
        status = "okay";
        dwc3@fe800000 {
            compatible = "snps,dwc3";
            reg = <0x0 0xFE800000 0x0 0x100000>;
            interrupts = <0x0 0x69 0x4 0x0>;
            dr_mode = "host";
            phys = <0x27 0x28>;
            phy-names = "usb2-phy", "usb3-phy";
            phy_type = "utmi_wide";
            snps,dis_enblslpm_quirk;
            snps,dis-u2-freeclk-exists-quirk;
            snps,dis_u2_susphy_quirk;
            snps,dis-del-phy-power-chg-quirk;
            snps,tx-ipgap-linecheck-dis-quirk;
            snps,xhci-slow-suspend-quirk;
            snps,xhci-trb-ent-quirk;
            snps,usb3-warm-reset-on-resume-quirk;
            status = "okay";
        };
    };
    usb@fe900000 {
        compatible = "rockchip,rk3399-dwc3";
        clocks = <0x8 0x82 0x8 0x84 0x8 0xF7 0x8 0xF9>;
        clock-names = "ref_clk", "suspend_clk", "bus_clk", "grf_clk";
        power-domains = <0x16 0x18>;
        resets = <0x8 0x126>;
        reset-names = "usb3-otg";
        #address-cells = <0x2>;
        #size-cells = <0x2>;
        ranges;
        status = "okay";
        dwc3@fe900000 {
            compatible = "snps,dwc3";
            reg = <0x0 0xFE900000 0x0 0x100000>;
            interrupts = <0x0 0x6E 0x4 0x0>;
            dr_mode = "host";
            phys = <0x29 0x2A>;
            phy-names = "usb2-phy", "usb3-phy";
            phy_type = "utmi_wide";
            snps,dis_enblslpm_quirk;
            snps,dis-u2-freeclk-exists-quirk;
            snps,dis_u2_susphy_quirk;
            snps,dis-del-phy-power-chg-quirk;
            snps,tx-ipgap-linecheck-dis-quirk;
            snps,xhci-slow-suspend-quirk;
            snps,xhci-trb-ent-quirk;
            snps,usb3-warm-reset-on-resume-quirk;
            status = "okay";
        };
    };
    dp@fec00000 {
        compatible = "rockchip,rk3399-cdn-dp";
        reg = <0x0 0xFEC00000 0x0 0x100000>;
        interrupts = <0x0 0x9 0x4 0x0>;
        clocks = <0x8 0x72 0x8 0x175 0x8 0xA1 0x8 0x16F>;
        clock-names = "core-clk", "pclk", "spdif", "grf";
        assigned-clocks = <0x8 0x72>;
        assigned-clock-rates = <0x5F5E100>;
        power-domains = <0x16 0x15>;
        phys = <0x2B 0x2C>;
        resets = <0x8 0x103 0x8 0x148 0x8 0x14A 0x8 0xFD>;
        reset-names = "spdif", "dptx", "apb", "core";
        rockchip,grf = <0x15>;
        #address-cells = <0x1>;
        #size-cells = <0x0>;
        #sound-dai-cells = <0x1>;
        status = "disabled";
        ports {
            #address-cells = <0x1>;
            #size-cells = <0x0>;
            port {
                #address-cells = <0x1>;
                #size-cells = <0x0>;
                endpoint@0 {
                    reg = <0x0>;
                    remote-endpoint = <0x2D>;
                    status = "disabled";
                    phandle = <0xB0>;
                };
                endpoint@1 {
                    reg = <0x1>;
                    remote-endpoint = <0x2E>;
                    phandle = <0xA9>;
                };
            };
        };
    };
    interrupt-controller@fee00000 {
        compatible = "arm,gic-v3";
        #interrupt-cells = <0x4>;
        #address-cells = <0x2>;
        #size-cells = <0x2>;
        ranges;
        interrupt-controller;
        reg = <0x0 0xFEE00000 0x0 0x10000 0x0 0xFEF00000 0x0 0xC0000 0x0 0xFFF00000 0x0 0x10000 0x0 0xFFF10000 0x0 0x10000 0x0 0xFFF20000 0x0 0x10000>;
        interrupts = <0x1 0x9 0x4 0x0>;
        phandle = <0x1>;
        interrupt-controller@fee20000 {
            compatible = "arm,gic-v3-its";
            msi-controller;
            reg = <0x0 0xFEE20000 0x0 0x20000>;
            phandle = <0x8B>;
        };
        ppi-partitions {
            interrupt-partition-0 {
                affinity = <0x2 0x3 0x4 0x5>;
                phandle = <0x13>;
            };
            interrupt-partition-1 {
                affinity = <0x6 0x7>;
                phandle = <0x14>;
            };
        };
    };
    saradc@ff100000 {
        compatible = "rockchip,rk3399-saradc";
        reg = <0x0 0xFF100000 0x0 0x100>;
        interrupts = <0x0 0x3E 0x4 0x0>;
        #io-channel-cells = <0x1>;
        clocks = <0x8 0x50 0x8 0x165>;
        clock-names = "saradc", "apb_pclk";
        resets = <0x8 0xD4>;
        reset-names = "saradc-apb";
        status = "okay";
        phandle = <0xCB>;
    };
    i2c@ff3c0000 {
        compatible = "rockchip,rk3399-i2c";
        reg = <0x0 0xFF3C0000 0x0 0x1000>;
        clocks = <0x2F 0x9 0x2F 0x1B>;
        clock-names = "i2c", "pclk";
        interrupts = <0x0 0x39 0x4 0x0>;
        pinctrl-names = "default";
        pinctrl-0 = <0x30>;
        #address-cells = <0x1>;
        #size-cells = <0x0>;
        status = "okay";
        i2c-scl-rising-time-ns = <0xB4>;
        i2c-scl-falling-time-ns = <0x1E>;
        clock-frequency = <0x61A80>;
        syr837@40 {
            compatible = "silergy,syr827";
            reg = <0x40>;
            vin-supply = <0x31>;
            regulator-compatible = "fan53555-reg";
            pinctrl-0 = <0x32>;
            vsel-gpios = <0x33 0x11 0x0>;
            regulator-name = "vdd_cpu_b";
            regulator-min-microvolt = <0xADF34>;
            regulator-max-microvolt = <0x16E360>;
            regulator-ramp-delay = <0x3E8>;
            fcs,suspend-voltage-selector = <0x1>;
            regulator-always-on;
            regulator-initial-state = <0x3>;
            phandle = <0x12>;
            regulator-state-mem {
                regulator-off-in-suspend;
            };
        };
        syr828@41 {
            compatible = "silergy,syr828";
            status = "okay";
            reg = <0x41>;
            vin-supply = <0x31>;
            regulator-compatible = "fan53555-reg";
            pinctrl-0 = <0x34>;
            vsel-gpios = <0x33 0xE 0x0>;
            regulator-name = "vdd_gpu";
            regulator-min-microvolt = <0xB3718>;
            regulator-max-microvolt = <0x155CC0>;
            regulator-ramp-delay = <0x3E8>;
            fcs,suspend-voltage-selector = <0x1>;
            regulator-boot-on;
            phandle = <0xA4>;
            regulator-state-mem {
                regulator-off-in-suspend;
            };
        };
        pmic@1b {
            compatible = "rockchip,rk808";
            reg = <0x1B>;
            interrupt-parent = <0x33>;
            interrupts = <0x15 0x8>;
            pinctrl-names = "default";
            pinctrl-0 = <0x35 0x36>;
            rockchip,system-power-controller;
            wakeup-source;
            #clock-cells = <0x1>;
            clock-output-names = "xin32k", "rk808-clkout2";
            vcc1-supply = <0x37>;
            vcc2-supply = <0x37>;
            vcc3-supply = <0x37>;
            vcc4-supply = <0x37>;
            vcc6-supply = <0x37>;
            vcc7-supply = <0x37>;
            vcc8-supply = <0x37>;
            vcc9-supply = <0x37>;
            vcc10-supply = <0x37>;
            vcc11-supply = <0x37>;
            vcc12-supply = <0x37>;
            vddio-supply = <0x38>;
            phandle = <0xE3>;
            regulators {
                DCDC_REG1 {
                    regulator-always-on;
                    regulator-boot-on;
                    regulator-min-microvolt = <0xB71B0>;
                    regulator-max-microvolt = <0x149970>;
                    regulator-ramp-delay = <0x1771>;
                    regulator-name = "vdd_center";
                    phandle = <0x96>;
                    regulator-state-mem {
                        regulator-off-in-suspend;
                    };
                };
                DCDC_REG2 {
                    regulator-always-on;
                    regulator-boot-on;
                    regulator-min-microvolt = <0xB71B0>;
                    regulator-max-microvolt = <0x149970>;
                    regulator-ramp-delay = <0x1771>;
                    regulator-name = "vdd_cpu_l";
                    phandle = <0xE>;
                    regulator-state-mem {
                        regulator-off-in-suspend;
                    };
                };
                DCDC_REG3 {
                    regulator-always-on;
                    regulator-boot-on;
                    regulator-name = "vcc_ddr";
                    regulator-state-mem {
                        regulator-on-in-suspend;
                    };
                };
                DCDC_REG4 {
                    regulator-always-on;
                    regulator-boot-on;
                    regulator-min-microvolt = <0x1B7740>;
                    regulator-max-microvolt = <0x1B7740>;
                    regulator-name = "vcc_1v8";
                    phandle = <0x7E>;
                    regulator-state-mem {
                        regulator-on-in-suspend;
                        regulator-suspend-microvolt = <0x1B7740>;
                    };
                };
                LDO_REG1 {
                    regulator-always-on;
                    regulator-boot-on;
                    regulator-min-microvolt = <0x1B7740>;
                    regulator-max-microvolt = <0x1B7740>;
                    regulator-name = "vcc1v8_dvp";
                    phandle = <0x9A>;
                    regulator-state-mem {
                        regulator-on-in-suspend;
                    };
                };
                LDO_REG2 {
                    regulator-always-on;
                    regulator-boot-on;
                    regulator-min-microvolt = <0x2DC6C0>;
                    regulator-max-microvolt = <0x2DC6C0>;
                    regulator-name = "vcc3v0_tp";
                    phandle = <0x40>;
                    regulator-state-mem {
                        regulator-off-in-suspend;
                    };
                };
                LDO_REG3 {
                    regulator-always-on;
                    regulator-boot-on;
                    regulator-min-microvolt = <0x1B7740>;
                    regulator-max-microvolt = <0x1B7740>;
                    regulator-name = "vcc1v8_pmu";
                    phandle = <0x38>;
                    regulator-state-mem {
                        regulator-on-in-suspend;
                        regulator-suspend-microvolt = <0x1B7740>;
                    };
                };
                LDO_REG4 {
                    regulator-always-on;
                    regulator-boot-on;
                    regulator-min-microvolt = <0x1B7740>;
                    regulator-max-microvolt = <0x2DC6C0>;
                    regulator-name = "vcc_sd";
                    phandle = <0x1F>;
                    regulator-state-mem {
                        regulator-on-in-suspend;
                        regulator-suspend-microvolt = <0x2DC6C0>;
                    };
                };
                LDO_REG5 {
                    regulator-always-on;
                    regulator-boot-on;
                    regulator-min-microvolt = <0x2DC6C0>;
                    regulator-max-microvolt = <0x2DC6C0>;
                    regulator-name = "vcca3v0_codec";
                    regulator-state-mem {
                        regulator-off-in-suspend;
                    };
                };
                LDO_REG6 {
                    regulator-always-on;
                    regulator-boot-on;
                    regulator-min-microvolt = <0x16E360>;
                    regulator-max-microvolt = <0x16E360>;
                    regulator-name = "vcc_1v5";
                    regulator-state-mem {
                        regulator-on-in-suspend;
                        regulator-suspend-microvolt = <0x16E360>;
                    };
                };
                LDO_REG7 {
                    regulator-always-on;
                    regulator-boot-on;
                    regulator-min-microvolt = <0x1B7740>;
                    regulator-max-microvolt = <0x1B7740>;
                    regulator-name = "vcca1v8_codec";
                    phandle = <0x9B>;
                    regulator-state-mem {
                        regulator-off-in-suspend;
                    };
                };
                LDO_REG8 {
                    regulator-always-on;
                    regulator-boot-on;
                    regulator-min-microvolt = <0x2DC6C0>;
                    regulator-max-microvolt = <0x2DC6C0>;
                    regulator-name = "vcc_3v0";
                    phandle = <0x9C>;
                    regulator-state-mem {
                        regulator-on-in-suspend;
                        regulator-suspend-microvolt = <0x2DC6C0>;
                    };
                };
                SWITCH_REG1 {
                    regulator-always-on;
                    regulator-boot-on;
                    regulator-name = "vcc3v3_s3";
                    regulator-state-mem {
                        regulator-off-in-suspend;
                    };
                };
                SWITCH_REG2 {
                    regulator-always-on;
                    regulator-boot-on;
                    regulator-name = "vcc3v3_s0";
                    regulator-state-mem {
                        regulator-off-in-suspend;
                    };
                };
            };
        };
    };
    i2c@ff110000 {
        compatible = "rockchip,rk3399-i2c";
        reg = <0x0 0xFF110000 0x0 0x1000>;
        clocks = <0x8 0x41 0x8 0x155>;
        clock-names = "i2c", "pclk";
        interrupts = <0x0 0x3B 0x4 0x0>;
        pinctrl-names = "default";
        pinctrl-0 = <0x39>;
        #address-cells = <0x1>;
        #size-cells = <0x0>;
        status = "okay";
        i2c-scl-rising-time-ns = <0x8C>;
        i2c-scl-falling-time-ns = <0x1E>;
        rt5651@1a {
            status = "okay";
            #sound-dai-cells = <0x0>;
            compatible = "rockchip,rt5651";
            reg = <0x1A>;
            clocks = <0x8 0x59>;
            clock-names = "mclk";
            pinctrl-names = "default";
            pinctrl-0 = <0x3A>;
            phandle = <0xDC>;
        };
        es8316@10 {
            #sound-dai-cells = <0x0>;
            compatible = "everest,es8316";
            reg = <0x10>;
            clocks = <0x8 0x59>;
            clock-names = "mclk";
            pinctrl-names = "default";
            pinctrl-0 = <0x3A 0x3B>;
            spk-con-gpio = <0x3C 0xB 0x0>;
            phandle = <0xDD>;
        };
    };
    i2c@ff120000 {
        compatible = "rockchip,rk3399-i2c";
        reg = <0x0 0xFF120000 0x0 0x1000>;
        clocks = <0x8 0x42 0x8 0x156>;
        clock-names = "i2c", "pclk";
        interrupts = <0x0 0x23 0x4 0x0>;
        pinctrl-names = "default";
        pinctrl-0 = <0x3D>;
        #address-cells = <0x1>;
        #size-cells = <0x0>;
        status = "disabled";
    };
    i2c@ff130000 {
        compatible = "rockchip,rk3399-i2c";
        reg = <0x0 0xFF130000 0x0 0x1000>;
        clocks = <0x8 0x43 0x8 0x157>;
        clock-names = "i2c", "pclk";
        interrupts = <0x0 0x22 0x4 0x0>;
        pinctrl-names = "default";
        pinctrl-0 = <0x3E>;
        #address-cells = <0x1>;
        #size-cells = <0x0>;
        status = "disabled";
    };
    i2c@ff140000 {
        compatible = "rockchip,rk3399-i2c";
        reg = <0x0 0xFF140000 0x0 0x1000>;
        clocks = <0x8 0x44 0x8 0x158>;
        clock-names = "i2c", "pclk";
        interrupts = <0x0 0x26 0x4 0x0>;
        pinctrl-names = "default";
        pinctrl-0 = <0x3F>;
        #address-cells = <0x1>;
        #size-cells = <0x0>;
        status = "disabled";
        i2c-scl-rising-time-ns = <0x96>;
        i2c-scl-falling-time-ns = <0x1E>;
        clock-frequency = <0x61A80>;
        gt9xx@14 {
            status = "disabled";
            compatible = "goodix,gt9xx";
            reg = <0x14>;
            touch-gpio = <0x18 0xC 0x8>;
            reset-gpio = <0x18 0xD 0x0>;
            max-x = <0x600>;
            max-y = <0x800>;
            tp-size = <0x3CA>;
            tp-supply = <0x40>;
        };
    };
    i2c@ff150000 {
        compatible = "rockchip,rk3399-i2c";
        reg = <0x0 0xFF150000 0x0 0x1000>;
        clocks = <0x8 0x45 0x8 0x159>;
        clock-names = "i2c", "pclk";
        interrupts = <0x0 0x25 0x4 0x0>;
        pinctrl-names = "default";
        pinctrl-0 = <0x41>;
        #address-cells = <0x1>;
        #size-cells = <0x0>;
        status = "disabled";
    };
    i2c@ff160000 {
        compatible = "rockchip,rk3399-i2c";
        reg = <0x0 0xFF160000 0x0 0x1000>;
        clocks = <0x8 0x46 0x8 0x15A>;
        clock-names = "i2c", "pclk";
        interrupts = <0x0 0x24 0x4 0x0>;
        pinctrl-names = "default";
        pinctrl-0 = <0x42>;
        #address-cells = <0x1>;
        #size-cells = <0x0>;
        status = "disabled";
    };
    serial@ff180000 {
        compatible = "rockchip,rk3399-uart", "snps,dw-apb-uart";
        reg = <0x0 0xFF180000 0x0 0x100>;
        clocks = <0x8 0x51 0x8 0x160>;
        clock-names = "baudclk", "apb_pclk";
        interrupts = <0x0 0x63 0x4 0x0>;
        reg-shift = <0x2>;
        reg-io-width = <0x4>;
        pinctrl-names = "default";
        pinctrl-0 = <0x43 0x44>;
        status = "okay";
        assigned-clocks = <0x8 0xAC>;
        assigned-clock-parents = <0x8 0x5>;
    };
    serial@ff190000 {
        compatible = "rockchip,rk3399-uart", "snps,dw-apb-uart";
        reg = <0x0 0xFF190000 0x0 0x100>;
        clocks = <0x8 0x52 0x8 0x161>;
        clock-names = "baudclk", "apb_pclk";
        interrupts = <0x0 0x62 0x4 0x0>;
        reg-shift = <0x2>;
        reg-io-width = <0x4>;
        pinctrl-names = "default";
        pinctrl-0 = <0x45>;
        status = "disabled";
        assigned-clocks = <0x8 0xAD>;
        assigned-clock-parents = <0x8 0x5>;
    };
    serial@ff1a0000 {
        compatible = "rockchip,rk3399-uart", "snps,dw-apb-uart";
        reg = <0x0 0xFF1A0000 0x0 0x100>;
        clocks = <0x8 0x53 0x8 0x162>;
        clock-names = "baudclk", "apb_pclk";
        interrupts = <0x0 0x64 0x4 0x0>;
        reg-shift = <0x2>;
        reg-io-width = <0x4>;
        pinctrl-names = "default";
        pinctrl-0 = <0x46>;
        status = "disabled";
        assigned-clocks = <0x8 0xAD>;
        assigned-clock-parents = <0x8 0x5>;
    };
    serial@ff1b0000 {
        compatible = "rockchip,rk3399-uart", "snps,dw-apb-uart";
        reg = <0x0 0xFF1B0000 0x0 0x100>;
        clocks = <0x8 0x54 0x8 0x163>;
        clock-names = "baudclk", "apb_pclk";
        interrupts = <0x0 0x65 0x4 0x0>;
        reg-shift = <0x2>;
        reg-io-width = <0x4>;
        pinctrl-names = "default";
        pinctrl-0 = <0x47>;
        status = "disabled";
        assigned-clocks = <0x8 0xAD>;
        assigned-clock-parents = <0x8 0x5>;
    };
    spi@ff1c0000 {
        compatible = "rockchip,rk3399-spi", "rockchip,rk3066-spi";
        reg = <0x0 0xFF1C0000 0x0 0x1000>;
        clocks = <0x8 0x47 0x8 0x15B>;
        clock-names = "spiclk", "apb_pclk";
        interrupts = <0x0 0x44 0x4 0x0>;
        dmas = <0x48 0xA 0x48 0xB>;
        dma-names = "tx", "rx";
        pinctrl-names = "default";
        pinctrl-0 = <0x49 0x4A 0x4B 0x4C>;
        #address-cells = <0x1>;
        #size-cells = <0x0>;
        status = "disabled";
    };
    spi@ff1d0000 {
        compatible = "rockchip,rk3399-spi", "rockchip,rk3066-spi";
        reg = <0x0 0xFF1D0000 0x0 0x1000>;
        clocks = <0x8 0x48 0x8 0x15C>;
        clock-names = "spiclk", "apb_pclk";
        interrupts = <0x0 0x35 0x4 0x0>;
        dmas = <0x48 0xC 0x48 0xD>;
        dma-names = "tx", "rx";
        pinctrl-names = "default";
        pinctrl-0 = <0x4D 0x4E 0x4F 0x50>;
        #address-cells = <0x1>;
        #size-cells = <0x0>;
        status = "disabled";
        max-freq = <0x2FAF080>;
        mpu6500@0 {
            status = "disabled";
            compatible = "inv-spi,mpu6500";
            pinctrl-names = "default";
            pinctrl-0 = <0x51>;
            irq-gpio = <0x52 0x1B 0x1>;
            reg = <0x0>;
            spi-max-frequency = <0xF4240>;
            spi-cpha;
            spi-cpol;
            mpu-int_config = <0x0>;
            mpu-level_shifter = <0x0>;
            mpu-orientation = <0x1 0x0 0x0 0x0 0x1 0x0 0x0 0x0 0x1>;
            orientation-x = <0x1>;
            orientation-y = <0x0>;
            orientation-z = <0x1>;
            support-hw-poweroff = <0x1>;
            mpu-debug = <0x1>;
        };
    };
    spi@ff1e0000 {
        compatible = "rockchip,rk3399-spi", "rockchip,rk3066-spi";
        reg = <0x0 0xFF1E0000 0x0 0x1000>;
        clocks = <0x8 0x49 0x8 0x15D>;
        clock-names = "spiclk", "apb_pclk";
        interrupts = <0x0 0x34 0x4 0x0>;
        dmas = <0x48 0xE 0x48 0xF>;
        dma-names = "tx", "rx";
        pinctrl-names = "default";
        pinctrl-0 = <0x53 0x54 0x55 0x56>;
        #address-cells = <0x1>;
        #size-cells = <0x0>;
        status = "disabled";
    };
    spi@ff1f0000 {
        compatible = "rockchip,rk3399-spi", "rockchip,rk3066-spi";
        reg = <0x0 0xFF1F0000 0x0 0x1000>;
        clocks = <0x8 0x4A 0x8 0x15E>;
        clock-names = "spiclk", "apb_pclk";
        interrupts = <0x0 0x43 0x4 0x0>;
        dmas = <0x48 0x12 0x48 0x13>;
        dma-names = "tx", "rx";
        pinctrl-names = "default";
        pinctrl-0 = <0x57 0x58 0x59 0x5A>;
        #address-cells = <0x1>;
        #size-cells = <0x0>;
        status = "disabled";
    };
    spi@ff200000 {
        compatible = "rockchip,rk3399-spi", "rockchip,rk3066-spi";
        reg = <0x0 0xFF200000 0x0 0x1000>;
        clocks = <0x8 0x4B 0x8 0x15F>;
        clock-names = "spiclk", "apb_pclk";
        interrupts = <0x0 0x84 0x4 0x0>;
        dmas = <0x5B 0x8 0x5B 0x9>;
        dma-names = "tx", "rx";
        pinctrl-names = "default";
        pinctrl-0 = <0x5C 0x5D 0x5E 0x5F>;
        #address-cells = <0x1>;
        #size-cells = <0x0>;
        power-domains = <0x16 0x1C>;
        status = "disabled";
    };
    thermal-zones {
        soc-thermal {
            polling-delay-passive = <0x14>;
            polling-delay = <0x3E8>;
            sustainable-power = <0x3E8>;
            thermal-sensors = <0x60 0x0>;
            trips {
                trip-point-0 {
                    temperature = <0x11170>;
                    hysteresis = <0x7D0>;
                    type = "passive";
                };
                trip-point-1 {
                    temperature = <0x14C08>;
                    hysteresis = <0x7D0>;
                    type = "passive";
                    phandle = <0x61>;
                };
                soc-crit {
                    temperature = <0x1C138>;
                    hysteresis = <0x7D0>;
                    type = "critical";
                };
            };
            cooling-maps {
                map0 {
                    trip = <0x61>;
                    cooling-device = <0x2 0xFFFFFFFF 0xFFFFFFFF>;
                    contribution = <0x1000>;
                };
                map1 {
                    trip = <0x61>;
                    cooling-device = <0x6 0xFFFFFFFF 0xFFFFFFFF>;
                    contribution = <0x400>;
                };
                map2 {
                    trip = <0x61>;
                    cooling-device = <0x62 0xFFFFFFFF 0xFFFFFFFF>;
                    contribution = <0x1000>;
                };
            };
        };
        gpu-thermal {
            polling-delay-passive = <0x64>;
            polling-delay = <0x3E8>;
            thermal-sensors = <0x60 0x1>;
        };
    };
    tsadc@ff260000 {
        compatible = "rockchip,rk3399-tsadc";
        reg = <0x0 0xFF260000 0x0 0x100>;
        interrupts = <0x0 0x61 0x4 0x0>;
        rockchip,grf = <0x15>;
        clocks = <0x8 0x4F 0x8 0x164>;
        clock-names = "tsadc", "apb_pclk";
        assigned-clocks = <0x8 0x4F>;
        assigned-clock-rates = <0xB71B0>;
        resets = <0x8 0xE8>;
        reset-names = "tsadc-apb";
        pinctrl-names = "init", "default", "sleep";
        pinctrl-0 = <0x63>;
        pinctrl-1 = <0x64>;
        pinctrl-2 = <0x63>;
        #thermal-sensor-cells = <0x1>;
        rockchip,hw-tshut-temp = <0x1D4C0>;
        status = "okay";
        rockchip,hw-tshut-mode = <0x1>;
        rockchip,hw-tshut-polarity = <0x1>;
        phandle = <0x60>;
    };
    qos@ffa58000 {
        compatible = "syscon";
        reg = <0x0 0xFFA58000 0x0 0x20>;
        phandle = <0x6C>;
    };
    qos@ffa5c000 {
        compatible = "syscon";
        reg = <0x0 0xFFA5C000 0x0 0x20>;
        phandle = <0x6D>;
    };
    qos@ffa60080 {
        compatible = "syscon";
        reg = <0x0 0xFFA60080 0x0 0x20>;
        phandle = <0x6F>;
    };
    qos@ffa60100 {
        compatible = "syscon";
        reg = <0x0 0xFFA60100 0x0 0x20>;
        phandle = <0x70>;
    };
    qos@ffa60180 {
        compatible = "syscon";
        reg = <0x0 0xFFA60180 0x0 0x20>;
        phandle = <0x71>;
    };
    qos@ffa70000 {
        compatible = "syscon";
        reg = <0x0 0xFFA70000 0x0 0x20>;
        phandle = <0x74>;
    };
    qos@ffa70080 {
        compatible = "syscon";
        reg = <0x0 0xFFA70080 0x0 0x20>;
        phandle = <0x75>;
    };
    qos@ffa74000 {
        compatible = "syscon";
        reg = <0x0 0xFFA74000 0x0 0x20>;
        phandle = <0x72>;
    };
    qos@ffa76000 {
        compatible = "syscon";
        reg = <0x0 0xFFA76000 0x0 0x20>;
        phandle = <0x73>;
    };
    qos@ffa90000 {
        compatible = "syscon";
        reg = <0x0 0xFFA90000 0x0 0x20>;
        phandle = <0x76>;
    };
    qos@ffa98000 {
        compatible = "syscon";
        reg = <0x0 0xFFA98000 0x0 0x20>;
        phandle = <0x65>;
    };
    qos@ffaa0000 {
        compatible = "syscon";
        reg = <0x0 0xFFAA0000 0x0 0x20>;
        phandle = <0x77>;
    };
    qos@ffaa0080 {
        compatible = "syscon";
        reg = <0x0 0xFFAA0080 0x0 0x20>;
        phandle = <0x78>;
    };
    qos@ffaa8000 {
        compatible = "syscon";
        reg = <0x0 0xFFAA8000 0x0 0x20>;
        phandle = <0x79>;
    };
    qos@ffaa8080 {
        compatible = "syscon";
        reg = <0x0 0xFFAA8080 0x0 0x20>;
        phandle = <0x7A>;
    };
    qos@ffab0000 {
        compatible = "syscon";
        reg = <0x0 0xFFAB0000 0x0 0x20>;
        phandle = <0x66>;
    };
    qos@ffab0080 {
        compatible = "syscon";
        reg = <0x0 0xFFAB0080 0x0 0x20>;
        phandle = <0x67>;
    };
    qos@ffab8000 {
        compatible = "syscon";
        reg = <0x0 0xFFAB8000 0x0 0x20>;
        phandle = <0x68>;
    };
    qos@ffac0000 {
        compatible = "syscon";
        reg = <0x0 0xFFAC0000 0x0 0x20>;
        phandle = <0x69>;
    };
    qos@ffac0080 {
        compatible = "syscon";
        reg = <0x0 0xFFAC0080 0x0 0x20>;
        phandle = <0x6A>;
    };
    qos@ffac8000 {
        compatible = "syscon";
        reg = <0x0 0xFFAC8000 0x0 0x20>;
        phandle = <0x7B>;
    };
    qos@ffac8080 {
        compatible = "syscon";
        reg = <0x0 0xFFAC8080 0x0 0x20>;
        phandle = <0x7C>;
    };
    qos@ffad0000 {
        compatible = "syscon";
        reg = <0x0 0xFFAD0000 0x0 0x20>;
        phandle = <0x7D>;
    };
    qos@ffad8080 {
        compatible = "syscon";
        reg = <0x0 0xFFAD8080 0x0 0x20>;
        phandle = <0x6E>;
    };
    qos@ffae0000 {
        compatible = "syscon";
        reg = <0x0 0xFFAE0000 0x0 0x20>;
        phandle = <0x6B>;
    };
    power-management@ff310000 {
        compatible = "rockchip,rk3399-pmu", "syscon", "simple-mfd";
        reg = <0x0 0xFF310000 0x0 0x1000>;
        power-controller {
            compatible = "rockchip,rk3399-power-controller";
            #power-domain-cells = <0x1>;
            #address-cells = <0x1>;
            #size-cells = <0x0>;
            phandle = <0x16>;
            pd_iep@34 {
                reg = <0x22>;
                clocks = <0x8 0xE1 0x8 0x1DD>;
                pm_qos = <0x65>;
            };
            pd_rga@33 {
                reg = <0x21>;
                clocks = <0x8 0xDC 0x8 0x1E5>;
                pm_qos = <0x66 0x67>;
            };
            pd_vcodec@31 {
                reg = <0x1F>;
                clocks = <0x8 0xEB 0x8 0x1EA>;
                pm_qos = <0x68>;
            };
            pd_vdu@32 {
                reg = <0x20>;
                clocks = <0x8 0xED 0x8 0x1EC>;
                pm_qos = <0x69 0x6A>;
            };
            pd_gpu@35 {
                reg = <0x23>;
                clocks = <0x8 0xD0>;
                pm_qos = <0x6B>;
            };
            pd_edp@25 {
                reg = <0x19>;
                clocks = <0x8 0x16C>;
            };
            pd_emmc@23 {
                reg = <0x17>;
                clocks = <0x8 0xF0>;
                pm_qos = <0x6C>;
            };
            pd_gmac@22 {
                reg = <0x16>;
                clocks = <0x8 0xD5 0x8 0x166>;
                pm_qos = <0x6D>;
            };
            pd_perihp@14 {
                reg = <0xE>;
                #address-cells = <0x1>;
                #size-cells = <0x0>;
                clocks = <0x8 0xC0>;
                pm_qos = <0x6E 0x6F 0x70 0x71>;
                pd_sd@27 {
                    reg = <0x1B>;
                    clocks = <0x8 0x1CE 0x8 0x4C>;
                    pm_qos = <0x72>;
                };
            };
            pd_sdioaudio@28 {
                reg = <0x1C>;
                clocks = <0x8 0x1EE>;
                pm_qos = <0x73>;
            };
            pd_usb3@24 {
                reg = <0x18>;
                clocks = <0x8 0xF4>;
                pm_qos = <0x74 0x75>;
            };
            pd_vio@15 {
                reg = <0xF>;
                #address-cells = <0x1>;
                #size-cells = <0x0>;
                pd_hdcp@21 {
                    reg = <0x15>;
                    clocks = <0x8 0xDE 0x8 0x1E7 0x8 0x172>;
                    pm_qos = <0x76>;
                };
                pd_isp0@19 {
                    reg = <0x13>;
                    clocks = <0x8 0xE5 0x8 0x1DF>;
                    pm_qos = <0x77 0x78>;
                };
                pd_isp1@20 {
                    reg = <0x14>;
                    clocks = <0x8 0xE6 0x8 0x1E0>;
                    pm_qos = <0x79 0x7A>;
                };
                pd_tcpc0@RK3399_PD_TCPC0 {
                    reg = <0x8>;
                    clocks = <0x8 0x7E 0x8 0x7D>;
                };
                pd_tcpc1@RK3399_PD_TCPC1 {
                    reg = <0x9>;
                    clocks = <0x8 0x80 0x8 0x7F>;
                };
                pd_vo@16 {
                    reg = <0x10>;
                    #address-cells = <0x1>;
                    #size-cells = <0x0>;
                    pd_vopb@17 {
                        reg = <0x11>;
                        clocks = <0x8 0xD9 0x8 0x1D9>;
                        pm_qos = <0x7B 0x7C>;
                    };
                    pd_vopl@18 {
                        reg = <0x12>;
                        clocks = <0x8 0xDB 0x8 0x1DB>;
                        pm_qos = <0x7D>;
                    };
                };
            };
        };
    };
    syscon@ff320000 {
        compatible = "rockchip,rk3399-pmugrf", "syscon", "simple-mfd";
        reg = <0x0 0xFF320000 0x0 0x1000>;
        #address-cells = <0x1>;
        #size-cells = <0x1>;
        phandle = <0x92>;
        io-domains {
            compatible = "rockchip,rk3399-pmu-io-voltage-domain";
            status = "okay";
            pmu1830-supply = <0x7E>;
        };
        reboot-mode {
            compatible = "syscon-reboot-mode";
            offset = <0x300>;
            mode-bootloader = <0x5242C301>;
            mode-charge = <0x5242C30B>;
            mode-fastboot = <0x5242C309>;
            mode-loader = <0x5242C301>;
            mode-normal = <0x5242C300>;
            mode-recovery = <0x5242C303>;
            mode-ums = <0x5242C30C>;
        };
        pmu-pvtm {
            compatible = "rockchip,rk3399-pmu-pvtm";
            clocks = <0x2F 0x7>;
            clock-names = "pmu";
            resets = <0x8 0x1B>;
            reset-names = "pmu";
            status = "disabled";
        };
    };
    spi@ff350000 {
        compatible = "rockchip,rk3399-spi", "rockchip,rk3066-spi";
        reg = <0x0 0xFF350000 0x0 0x1000>;
        clocks = <0x2F 0x3 0x2F 0x1F>;
        clock-names = "spiclk", "apb_pclk";
        interrupts = <0x0 0x3C 0x4 0x0>;
        pinctrl-names = "default";
        pinctrl-0 = <0x7F 0x80 0x81 0x82>;
        #address-cells = <0x1>;
        #size-cells = <0x0>;
        status = "disabled";
    };
    serial@ff370000 {
        compatible = "rockchip,rk3399-uart", "snps,dw-apb-uart";
        reg = <0x0 0xFF370000 0x0 0x100>;
        clocks = <0x2F 0x6 0x2F 0x22>;
        clock-names = "baudclk", "apb_pclk";
        interrupts = <0x0 0x66 0x4 0x0>;
        reg-shift = <0x2>;
        reg-io-width = <0x4>;
        pinctrl-names = "default";
        pinctrl-0 = <0x83>;
        status = "okay";
        assigned-clocks = <0x2F 0xC>;
        assigned-clock-parents = <0x2F 0x1>;
    };
    i2c@ff3d0000 {
        compatible = "rockchip,rk3399-i2c";
        reg = <0x0 0xFF3D0000 0x0 0x1000>;
        clocks = <0x2F 0xA 0x2F 0x1C>;
        clock-names = "i2c", "pclk";
        interrupts = <0x0 0x38 0x4 0x0>;
        pinctrl-names = "default";
        pinctrl-0 = <0x84>;
        #address-cells = <0x1>;
        #size-cells = <0x0>;
        status = "okay";
        i2c-scl-rising-time-ns = <0x159>;
        i2c-scl-falling-time-ns = <0xB>;
        clock-frequency = <0x61A80>;
        lsm330_accel@1e {
            status = "disabled";
            compatible = "lsm330_acc";
            pinctrl-names = "default";
            pinctrl-0 = <0x85>;
            reg = <0x1E>;
            irq-gpio = <0x52 0x1B 0x1>;
            type = <0x2>;
            irq_enable = <0x1>;
            poll_delay_ms = <0x1E>;
            power-off-in-suspend = <0x1>;
            layout = <0x4>;
        };
        lsm330_gyro@6a {
            status = "disabled";
            compatible = "lsm330_gyro";
            pinctrl-names = "default";
            pinctrl-0 = <0x86>;
            reg = <0x6A>;
            irq-gpio = <0x33 0x14 0x1>;
            type = <0x4>;
            irq_enable = <0x0>;
            power-off-in-suspend = <0x1>;
            poll_delay_ms = <0x1E>;
        };
        mpu6500@68 {
            status = "disabled";
            compatible = "invensense,mpu6500";
            pinctrl-names = "default";
            pinctrl-0 = <0x51>;
            reg = <0x68>;
            irq-gpio = <0x52 0x1B 0x1>;
            mpu-int_config = <0x10>;
            mpu-level_shifter = <0x0>;
            mpu-orientation = <0x1 0x0 0x0 0x0 0x1 0x0 0x0 0x0 0x1>;
            orientation-x = <0x1>;
            orientation-y = <0x1>;
            orientation-z = <0x0>;
            support-hw-poweroff = <0x1>;
            mpu-debug = <0x1>;
        };
        sensor@0d {
            status = "disabled";
            compatible = "ak8963";
            pinctrl-names = "default";
            pinctrl-0 = <0x87>;
            reg = <0xD>;
            type = <0x3>;
            irq-gpio = <0x52 0x1C 0x1>;
            irq_enable = <0x0>;
            poll_delay_ms = <0x1E>;
            layout = <0x3>;
        };
        sensor@10 {
            status = "disabled";
            compatible = "capella,light_cm3218";
            pinctrl-names = "default";
            pinctrl-0 = <0x88>;
            reg = <0x10>;
            type = <0x5>;
            irq-gpio = <0x89 0x18 0x2>;
            irq_enable = <0x1>;
            poll_delay_ms = <0x1E>;
        };
    };
    i2c@ff3e0000 {
        compatible = "rockchip,rk3399-i2c";
        reg = <0x0 0xFF3E0000 0x0 0x1000>;
        clocks = <0x2F 0xB 0x2F 0x1D>;
        clock-names = "i2c", "pclk";
        interrupts = <0x0 0x3A 0x4 0x0>;
        pinctrl-names = "default";
        pinctrl-0 = <0x8A>;
        #address-cells = <0x1>;
        #size-cells = <0x0>;
        status = "disabled";
    };
    pcie-phy {
        compatible = "rockchip,rk3399-pcie-phy";
        #phy-cells = <0x0>;
        rockchip,grf = <0x15>;
        clocks = <0x8 0x8A>;
        clock-names = "refclk";
        resets = <0x8 0x87>;
        reset-names = "phy";
        status = "disabled";
        phandle = <0x8D>;
    };
    pcie@f8000000 {
        compatible = "rockchip,rk3399-pcie";
        #address-cells = <0x3>;
        #size-cells = <0x2>;
        aspm-no-l0s;
        clocks = <0x8 0xC5 0x8 0xC4 0x8 0x147 0x8 0xA0>;
        clock-names = "aclk", "aclk-perf", "hclk", "pm";
        bus-range = <0x0 0x1F>;
        max-link-speed = <0x1>;
        linux,pci-domain = <0x0>;
        msi-map = <0x0 0x8B 0x0 0x1000>;
        interrupts = <0x0 0x31 0x4 0x0 0x0 0x32 0x4 0x0 0x0 0x33 0x4 0x0>;
        interrupt-names = "sys", "legacy", "client";
        #interrupt-cells = <0x1>;
        interrupt-map-mask = <0x0 0x0 0x0 0x7>;
        interrupt-map = <0x0 0x0 0x0 0x1 0x8C 0x0 0x0 0x0 0x0 0x2 0x8C 0x1 0x0 0x0 0x0 0x3 0x8C 0x2 0x0 0x0 0x0 0x4 0x8C 0x3>;
        phys = <0x8D>;
        phy-names = "pcie-phy";
        ranges = <0x83000000 0x0 0xFA000000 0x0 0xFA000000 0x0 0x1E00000 0x81000000 0x0 0xFBE00000 0x0 0xFBE00000 0x0 0x100000>;
        reg = <0x0 0xF8000000 0x0 0x2000000 0x0 0xFD000000 0x0 0x1000000>;
        reg-names = "axi-base", "apb-base";
        resets = <0x8 0x82 0x8 0x83 0x8 0x84 0x8 0x85 0x8 0x86 0x8 0x81 0x8 0x80>;
        reset-names = "core", "mgmt", "mgmt-sticky", "pipe", "pm", "pclk", "aclk";
        status = "disabled";
        interrupt-controller {
            interrupt-controller;
            #address-cells = <0x0>;
            #interrupt-cells = <0x1>;
            phandle = <0x8C>;
        };
    };
    pwm@ff420000 {
        compatible = "rockchip,rk3399-pwm", "rockchip,rk3288-pwm";
        reg = <0x0 0xFF420000 0x0 0x10>;
        #pwm-cells = <0x3>;
        pinctrl-names = "active";
        pinctrl-0 = <0x8E>;
        clocks = <0x2F 0x1E>;
        clock-names = "pwm";
        status = "okay";
        phandle = <0xD9>;
    };
    pwm@ff420010 {
        compatible = "rockchip,rk3399-pwm", "rockchip,rk3288-pwm";
        reg = <0x0 0xFF420010 0x0 0x10>;
        #pwm-cells = <0x3>;
        pinctrl-names = "active";
        pinctrl-0 = <0x8F>;
        clocks = <0x2F 0x1E>;
        clock-names = "pwm";
        status = "okay";
        phandle = <0xDA>;
    };
    pwm@ff420020 {
        compatible = "rockchip,rk3399-pwm", "rockchip,rk3288-pwm";
        reg = <0x0 0xFF420020 0x0 0x10>;
        #pwm-cells = <0x3>;
        pinctrl-names = "active";
        pinctrl-0 = <0x90>;
        clocks = <0x2F 0x1E>;
        clock-names = "pwm";
        status = "okay";
        phandle = <0xD8>;
    };
    pwm@ff420030 {
        compatible = "rockchip,remotectl-pwm";
        reg = <0x0 0xFF420030 0x0 0x10>;
        #pwm-cells = <0x3>;
        pinctrl-names = "default";
        pinctrl-0 = <0x91>;
        clocks = <0x2F 0x1E>;
        clock-names = "pwm";
        status = "okay";
        interrupts = <0x0 0x3D 0x4 0x0>;
        remote_pwm_id = <0x3>;
        handle_cpu_id = <0x1>;
        remote_support_psci = <0x1>;
        ir_key1 {
            rockchip,usercode = <0xFE01>;
            rockchip,key_table = <0xF8 0xE8 0xDA 0x9E 0xFC 0x67 0xF7 0x6C 0xFA 0x69 0xF9 0x6A 0xD8 0x66 0xD6 0x73 0xD7 0x72 0xFE 0x74 0xFD 0x8B 0xD9 0x184>;
        };
        ir_key2 {
            rockchip,usercode = <0xDF20>;
            rockchip,key_table = <0xE4 0xE8 0xEB 0x9E 0xBD 0x67 0xBC 0x6C 0xE5 0x69 0xB0 0x6A 0xB2 0x66 0xAE 0x73 0xA9 0x72 0xBE 0x74 0xAF 0x8B 0xA5 0x184>;
        };
    };
    dfi@ff630000 {
        reg = <0x0 0xFF630000 0x0 0x4000>;
        compatible = "rockchip,rk3399-dfi";
        rockchip,pmu = <0x92>;
        clocks = <0x8 0x179>;
        clock-names = "pclk_ddr_mon";
        status = "disabled";
        phandle = <0x93>;
    };
    dmc {
        compatible = "rockchip,rk3399-dmc";
        devfreq-events = <0x93>;
        interrupts = <0x0 0x1 0x4 0x0>;
        clocks = <0x8 0xAA>;
        clock-names = "dmc_clk";
        ddr_timing = <0x94>;
        upthreshold = <0x28>;
        downdifferential = <0x14>;
        system-status-freq = <0x1 0xD0FC0 0x8 0xD0FC0 0x2 0x65900 0x20 0xD0FC0 0x10 0xD0FC0 0x10000 0xD0FC0 0x2000 0xD0FC0 0x1000 0xD0FC0 0xC00 0xD0FC0 0x4000 0xD0FC0>;
        vop-pn-msch-readlatency = <0x0 0x20 0x4 0x20>;
        auto-min-freq = <0x65900>;
        auto-freq-en = <0x1>;
        status = "okay";
        operating-points-v2 = <0x95>;
        center-supply = <0x96>;
        vop-bw-dmc-freq = <0x0 0x241 0x65900 0x242 0x1869F 0xD0FC0>;
        phandle = <0xB3>;
    };
    vpu_service@ff650000 {
        compatible = "rockchip,vpu_service";
        rockchip,grf = <0x15>;
        iommus = <0x97>;
        iommu_enabled = <0x1>;
        reg = <0x0 0xFF650000 0x0 0x800>;
        interrupts = <0x0 0x71 0x4 0x0 0x0 0x72 0x4 0x0>;
        interrupt-names = "irq_dec", "irq_enc";
        clocks = <0x8 0xEB 0x8 0x1EA>;
        clock-names = "aclk_vcodec", "hclk_vcodec";
        resets = <0x8 0x53 0x8 0x51>;
        reset-names = "video_h", "video_a";
        power-domains = <0x16 0x1F>;
        dev_mode = <0x0>;
        allocator = <0x1>;
        status = "okay";
    };
    iommu@ff650800 {
        compatible = "rockchip,iommu";
        reg = <0x0 0xFF650800 0x0 0x40>;
        interrupts = <0x0 0x73 0x4 0x0>;
        interrupt-names = "vpu_mmu";
        clocks = <0x8 0xEB 0x8 0x1EA>;
        clock-names = "aclk", "hclk";
        power-domains = <0x16 0x1F>;
        #iommu-cells = <0x0>;
        phandle = <0x97>;
    };
    rkvdec@ff660000 {
        compatible = "rockchip,rkvdec";
        rockchip,grf = <0x15>;
        iommus = <0x98>;
        iommu_enabled = <0x1>;
        reg = <0x0 0xFF660000 0x0 0x400>;
        interrupts = <0x0 0x74 0x4 0x0>;
        interrupt-names = "irq_dec";
        clocks = <0x8 0xED 0x8 0x1EC 0x8 0x9F 0x8 0x9E>;
        clock-names = "aclk_vcodec", "hclk_vcodec", "clk_cabac", "clk_core";
        resets = <0x8 0x5B 0x8 0x59 0x8 0x5C 0x8 0x5D 0x8 0x58 0x8 0x5A>;
        reset-names = "video_h", "video_a", "video_core", "video_cabac", "niu_a", "niu_h";
        power-domains = <0x16 0x20>;
        dev_mode = <0x2>;
        allocator = <0x1>;
        status = "okay";
    };
    iommu@ff660480 {
        compatible = "rockchip,iommu";
        reg = <0x0 0xFF660480 0x0 0x40 0x0 0xFF6604C0 0x0 0x40>;
        interrupts = <0x0 0x75 0x4 0x0>;
        interrupt-names = "vdec_mmu";
        clocks = <0x8 0xED 0x8 0x1EC>;
        clock-names = "aclk", "hclk";
        power-domains = <0x16 0x20>;
        #iommu-cells = <0x0>;
        phandle = <0x98>;
    };
    iep@ff670000 {
        compatible = "rockchip,iep";
        iommu_enabled = <0x1>;
        iommus = <0x99>;
        reg = <0x0 0xFF670000 0x0 0x800>;
        interrupts = <0x0 0x2A 0x4 0x0>;
        clocks = <0x8 0xE1 0x8 0x1DD>;
        clock-names = "aclk_iep", "hclk_iep";
        power-domains = <0x16 0x22>;
        allocator = <0x1>;
        version = <0x2>;
        status = "okay";
    };
    iommu@ff670800 {
        compatible = "rockchip,iommu";
        reg = <0x0 0xFF670800 0x0 0x40>;
        interrupts = <0x0 0x2A 0x4 0x0>;
        interrupt-names = "iep_mmu";
        #iommu-cells = <0x0>;
        status = "okay";
        phandle = <0x99>;
    };
    rga@ff680000 {
        compatible = "rockchip,rga2";
        reg = <0x0 0xFF680000 0x0 0x1000>;
        interrupts = <0x0 0x37 0x4 0x0>;
        clocks = <0x8 0xDC 0x8 0x1E5 0x8 0x6D>;
        clock-names = "aclk_rga", "hclk_rga", "clk_rga";
        resets = <0x8 0x6A 0x8 0x67 0x8 0x69>;
        reset-names = "core", "axi", "ahb";
        power-domains = <0x16 0x21>;
        status = "okay";
        dev_mode = <0x1>;
        dma-coherent;
    };
    efuse@ff690000 {
        compatible = "rockchip,rk3399-efuse";
        reg = <0x0 0xFF690000 0x0 0x80>;
        #address-cells = <0x1>;
        #size-cells = <0x1>;
        clocks = <0x8 0x17D>;
        clock-names = "pclk_efuse";
        specification-serial-number@6 {
            reg = <0x6 0x1>;
            bits = <0x0 0x5>;
            phandle = <0xD2>;
        };
        cpu-id@7 {
            reg = <0x7 0x10>;
            phandle = <0xC9>;
        };
        cpu-leakage@17 {
            reg = <0x17 0x1>;
            phandle = <0xD3>;
        };
        gpu-leakage@18 {
            reg = <0x18 0x1>;
            phandle = <0xD4>;
        };
        center-leakage@19 {
            reg = <0x19 0x1>;
        };
        cpu-leakage@1a {
            reg = <0x1A 0x1>;
            phandle = <0xD1>;
        };
        logic-leakage@1b {
            reg = <0x1B 0x1>;
        };
        wafer-info@1c {
            reg = <0x1C 0x1>;
        };
    };
    pmu-clock-controller@ff750000 {
        compatible = "rockchip,rk3399-pmucru";
        reg = <0x0 0xFF750000 0x0 0x1000>;
        #clock-cells = <0x1>;
        #reset-cells = <0x1>;
        assigned-clocks = <0x2F 0x1 0x2F 0x2C>;
        assigned-clock-rates = <0x284AF100 0x5C81A40>;
        phandle = <0x2F>;
    };
    clock-controller@ff760000 {
        compatible = "rockchip,rk3399-cru";
        reg = <0x0 0xFF760000 0x0 0x1000>;
        #clock-cells = <0x1>;
        #reset-cells = <0x1>;
        assigned-clocks = <0x8 0xC0 0x8 0xC2 0x8 0x1C2 0x8 0x4C 0x8 0xF0 0x8 0xCD 0x8 0x1CD 0x8 0x9F 0x8 0x9E 0x8 0xF4 0x8 0xBE 0x8 0xC9 0x8 0x186 0x8 0xD5 0x8 0x88 0x8 0x87 0x8 0x8 0x8 0x9 0x8 0x6 0x8 0xD0 0x8 0x5 0x8 0xC0 0x8 0x1C0 0x8 0x140 0x8 0xC2 0x8 0x1C1 0x8 0x142 0x8 0x1C2 0x8 0x143 0x8 0x41 0x8 0x42 0x8 0x43 0x8 0x44 0x8 0x45 0x8 0x46 0x8 0x47 0x8 0x48 0x8 0x49 0x8 0x4A 0x8 0x4B 0x8 0xFA 0x8 0xE5 0x8 0xE6 0x8 0x6B 0x8 0x6C 0x8 0x16A 0x8 0xDE 0x8 0xE3 0x8 0x1CD 0x8 0x85 0x8 0x86 0x8 0x4E 0x8 0xF0 0x8 0xCD 0x8 0xE1 0x8 0xDC 0x8 0x6D 0x8 0xED 0x8 0xEB 0x8 0x178 0x8 0xD5 0x8 0x9F 0x8 0x9E 0x8 0xF4 0x8 0xBE 0x8 0xC9 0x8 0x186 0x8 0x88 0x8 0x87 0x8 0xD9 0x8 0x1D9 0x8 0xDB 0x8 0x1DB>;
        assigned-clock-rates = <0x47868C0 0x2FAF080 0x2FAF080 0x2FAF080 0x2FAF080 0x5F5E100 0x2FAF080 0x8F0D180 0x8F0D180 0x8F0D180 0x2FAF080 0x8F0D180 0x2FAF080 0x5F5E100 0x47868C0 0x47868C0 0x30A32C00 0x30A32C00 0x23C34600 0xBEBC200 0x2FAF0800 0x8F0D180 0x47868C0 0x23C3460 0x11E1A300 0x5F5E100 0x2FAF080 0x5F5E100 0x2FAF080 0x5F5E100 0x5F5E100 0x5F5E100 0x5F5E100 0x5F5E100 0x5F5E100 0x2FAF080 0x2FAF080 0x2FAF080 0x2FAF080 0x2FAF080 0xBEBC200 0x17D78400 0x17D78400 0x5F5E100 0x5F5E100 0x5F5E100 0x17D78400 0x17D78400 0xBEBC200 0x5F5E100 0xBEBC200 0xBEBC200 0x5F5E100 0x17D78400 0x17D78400 0x17D78400 0x17D78400 0x11E1A300 0x17D78400 0xBEBC200 0x17D78400 0x11E1A300 0x11E1A300 0x11E1A300 0x11E1A300 0x11E1A300 0x5F5E100 0x8F0D180 0x8F0D180 0x17D78400 0x5F5E100 0x17D78400 0x5F5E100>;
        phandle = <0x8>;
    };
    syscon@ff770000 {
        compatible = "rockchip,rk3399-grf", "syscon", "simple-mfd";
        reg = <0x0 0xFF770000 0x0 0x10000>;
        #address-cells = <0x1>;
        #size-cells = <0x1>;
        phandle = <0x15>;
        io-domains {
            compatible = "rockchip,rk3399-io-voltage-domain";
            status = "okay";
            bt656-supply = <0x9A>;
            audio-supply = <0x9B>;
            sdmmc-supply = <0x1F>;
            gpio1830-supply = <0x9C>;
        };
        phy@f780 {
            compatible = "rockchip,rk3399-emmc-phy";
            reg = <0xF780 0x24>;
            clocks = <0x9D>;
            clock-names = "emmcclk";
            #phy-cells = <0x0>;
            status = "okay";
            phandle = <0x24>;
        };
        usb2-phy@e450 {
            compatible = "rockchip,rk3399-usb2phy";
            reg = <0xE450 0x10>;
            clocks = <0x8 0x7B>;
            clock-names = "phyclk";
            #clock-cells = <0x0>;
            clock-output-names = "clk_usbphy0_480m";
            status = "okay";
            otg-port {
                #phy-cells = <0x0>;
                interrupts = <0x0 0x67 0x4 0x0 0x0 0x68 0x4 0x0 0x0 0x6A 0x4 0x0>;
                interrupt-names = "otg-bvalid", "otg-id", "linestate";
                status = "okay";
                phandle = <0x27>;
            };
            host-port {
                #phy-cells = <0x0>;
                interrupts = <0x0 0x1B 0x4 0x0>;
                interrupt-names = "linestate";
                status = "okay";
                phy-supply = <0x9E>;
                phandle = <0x25>;
            };
        };
        usb2-phy@e460 {
            compatible = "rockchip,rk3399-usb2phy";
            reg = <0xE460 0x10>;
            clocks = <0x8 0x7C>;
            clock-names = "phyclk";
            #clock-cells = <0x0>;
            clock-output-names = "clk_usbphy1_480m";
            status = "okay";
            otg-port {
                #phy-cells = <0x0>;
                interrupts = <0x0 0x6C 0x4 0x0 0x0 0x6D 0x4 0x0 0x0 0x6F 0x4 0x0>;
                interrupt-names = "otg-bvalid", "otg-id", "linestate";
                status = "okay";
                phandle = <0x29>;
            };
            host-port {
                #phy-cells = <0x0>;
                interrupts = <0x0 0x1F 0x4 0x0>;
                interrupt-names = "linestate";
                status = "okay";
                phy-supply = <0x9F>;
                phandle = <0x26>;
            };
        };
        mipi-dphy-rx0 {
            compatible = "rockchip,rk3399-mipi-dphy";
            clocks = <0x8 0x77 0x8 0xA5 0x8 0x16F>;
            clock-names = "dphy-ref", "dphy-cfg", "grf";
            power-domains = <0x16 0xF>;
            status = "disabled";
        };
        pvtm {
            compatible = "rockchip,rk3399-pvtm";
            clocks = <0x8 0x73 0x8 0x74 0x8 0x75 0x8 0x76>;
            clock-names = "core_l", "core_b", "gpu", "ddr";
            resets = <0x8 0x1F 0x8 0x2F 0x8 0x123 0x8 0x4F>;
            reset-names = "core_l", "core_b", "gpu", "ddr";
            status = "okay";
        };
    };
    phy@ff7c0000 {
        compatible = "rockchip,rk3399-typec-phy";
        reg = <0x0 0xFF7C0000 0x0 0x40000>;
        rockchip,grf = <0x15>;
        #phy-cells = <0x1>;
        clocks = <0x8 0x7E 0x8 0x7D>;
        clock-names = "tcpdcore", "tcpdphy-ref";
        assigned-clocks = <0x8 0x7E>;
        assigned-clock-rates = <0x2FAF080>;
        power-domains = <0x16 0x8>;
        resets = <0x8 0x95 0x8 0x94 0x8 0x14C>;
        reset-names = "uphy", "uphy-pipe", "uphy-tcphy";
        rockchip,typec-conn-dir = <0xE580 0x0 0x10>;
        rockchip,usb3tousb2-en = <0xE580 0x3 0x13>;
        rockchip,usb3-host-disable = <0x2434 0x0 0x10>;
        rockchip,usb3-host-port = <0x2434 0xC 0x1C>;
        rockchip,external-psm = <0xE588 0xE 0x1E>;
        rockchip,pipe-status = <0xE5C0 0x0 0x0>;
        rockchip,uphy-dp-sel = <0x6268 0x13 0x13>;
        status = "okay";
        dp-port {
            #phy-cells = <0x0>;
            phandle = <0x2B>;
        };
        usb3-port {
            #phy-cells = <0x0>;
            phandle = <0x28>;
        };
    };
    phy@ff800000 {
        compatible = "rockchip,rk3399-typec-phy";
        reg = <0x0 0xFF800000 0x0 0x40000>;
        rockchip,grf = <0x15>;
        #phy-cells = <0x1>;
        clocks = <0x8 0x80 0x8 0x7F>;
        clock-names = "tcpdcore", "tcpdphy-ref";
        assigned-clocks = <0x8 0x80>;
        assigned-clock-rates = <0x2FAF080>;
        power-domains = <0x16 0x9>;
        resets = <0x8 0x9D 0x8 0x9C 0x8 0x14D>;
        reset-names = "uphy", "uphy-pipe", "uphy-tcphy";
        rockchip,typec-conn-dir = <0xE58C 0x0 0x10>;
        rockchip,usb3tousb2-en = <0xE58C 0x3 0x13>;
        rockchip,usb3-host-disable = <0x2444 0x0 0x10>;
        rockchip,usb3-host-port = <0x2444 0xC 0x1C>;
        rockchip,external-psm = <0xE594 0xE 0x1E>;
        rockchip,pipe-status = <0xE5C0 0x10 0x10>;
        rockchip,uphy-dp-sel = <0x6268 0x3 0x13>;
        status = "okay";
        dp-port {
            #phy-cells = <0x0>;
            phandle = <0x2C>;
        };
        usb3-port {
            #phy-cells = <0x0>;
            phandle = <0x2A>;
        };
    };
    watchdog@ff848000 {
        compatible = "snps,dw-wdt";
        reg = <0x0 0xFF848000 0x0 0x100>;
        clocks = <0x8 0x17C>;
        interrupts = <0x0 0x78 0x4 0x0>;
    };
    rktimer@ff850000 {
        compatible = "rockchip,rk3399-timer";
        reg = <0x0 0xFF850000 0x0 0x1000>;
        interrupts = <0x0 0x51 0x4 0x0>;
        clocks = <0x8 0x168 0x8 0x5A>;
        clock-names = "pclk", "timer";
    };
    spdif@ff870000 {
        compatible = "rockchip,rk3399-spdif";
        reg = <0x0 0xFF870000 0x0 0x1000>;
        interrupts = <0x0 0x42 0x4 0x0>;
        dmas = <0x5B 0x7>;
        dma-names = "tx";
        clock-names = "mclk", "hclk";
        clocks = <0x8 0x55 0x8 0x1D7>;
        pinctrl-names = "default";
        pinctrl-0 = <0xA0>;
        power-domains = <0x16 0x1C>;
        status = "disabled";
        assigned-clocks = <0x8 0xB1>;
        assigned-clock-parents = <0x8 0x5>;
        #sound-dai-cells = <0x0>;
        phandle = <0xDE>;
    };
    i2s@ff880000 {
        compatible = "rockchip,rk3399-i2s", "rockchip,rk3066-i2s";
        reg = <0x0 0xFF880000 0x0 0x1000>;
        rockchip,grf = <0x15>;
        interrupts = <0x0 0x27 0x4 0x0>;
        dmas = <0x5B 0x0 0x5B 0x1>;
        dma-names = "tx", "rx";
        clock-names = "i2s_clk", "i2s_hclk";
        clocks = <0x8 0x56 0x8 0x1D4>;
        pinctrl-names = "default";
        pinctrl-0 = <0xA1>;
        power-domains = <0x16 0x1C>;
        status = "okay";
        assigned-clocks = <0x8 0xAE>;
        assigned-clock-parents = <0x8 0x5>;
        rockchip,i2s-broken-burst-len;
        rockchip,playback-channels = <0x8>;
        rockchip,capture-channels = <0x8>;
        #sound-dai-cells = <0x0>;
        phandle = <0xDB>;
    };
    i2s@ff890000 {
        compatible = "rockchip,rk3399-i2s", "rockchip,rk3066-i2s";
        reg = <0x0 0xFF890000 0x0 0x1000>;
        interrupts = <0x0 0x28 0x4 0x0>;
        dmas = <0x5B 0x2 0x5B 0x3>;
        dma-names = "tx", "rx";
        clock-names = "i2s_clk", "i2s_hclk";
        clocks = <0x8 0x57 0x8 0x1D5>;
        pinctrl-names = "default";
        pinctrl-0 = <0xA2>;
        power-domains = <0x16 0x1C>;
        status = "disabled";
        assigned-clocks = <0x8 0xAF>;
        assigned-clock-parents = <0x8 0x5>;
    };
    i2s@ff8a0000 {
        compatible = "rockchip,rk3399-i2s", "rockchip,rk3066-i2s";
        reg = <0x0 0xFF8A0000 0x0 0x1000>;
        interrupts = <0x0 0x29 0x4 0x0>;
        dmas = <0x5B 0x4 0x5B 0x5>;
        dma-names = "tx", "rx";
        clock-names = "i2s_clk", "i2s_hclk";
        clocks = <0x8 0x58 0x8 0x1D6>;
        power-domains = <0x16 0x1C>;
        status = "okay";
        assigned-clocks = <0x8 0xB0>;
        assigned-clock-parents = <0x8 0x5>;
        #sound-dai-cells = <0x0>;
        rockchip,bclk-fs = <0x80>;
        phandle = <0xE0>;
    };
    gpu@ff9a0000 {
        compatible = "arm,malit860", "arm,malit86x", "arm,malit8xx", "arm,mali-midgard";
        reg = <0x0 0xFF9A0000 0x0 0x10000>;
        interrupts = <0x0 0x13 0x4 0x0 0x0 0x14 0x4 0x0 0x0 0x15 0x4 0x0>;
        interrupt-names = "GPU", "JOB", "MMU";
        clocks = <0x8 0xD0>;
        clock-names = "clk_mali";
        #cooling-cells = <0x2>;
        power-domains = <0x16 0x23>;
        power-off-delay-ms = <0xC8>;
        status = "okay";
        operating-points-v2 = <0xA3>;
        mali-supply = <0xA4>;
        phandle = <0x62>;
        power_model {
            compatible = "arm,mali-simple-power-model";
            static-coefficient = <0x64578>;
            dynamic-coefficient = <0x2DD>;
            ts = <0x7D00 0x125C 0xFFFFFFB0 0x2>;
            thermal-zone = "gpu-thermal";
        };
    };
    vop@ff8f0000 {
        compatible = "rockchip,rk3399-vop-lit";
        reg = <0x0 0xFF8F0000 0x0 0x600 0x0 0xFF8F1C00 0x0 0x200 0x0 0xFF8F2000 0x0 0x400>;
        reg-names = "regs", "cabc_lut", "gamma_lut";
        interrupts = <0x0 0x77 0x4 0x0>;
        clocks = <0x8 0xDB 0x8 0xB5 0x8 0x1DB 0x8 0xB7>;
        clock-names = "aclk_vop", "dclk_vop", "hclk_vop", "dclk_source";
        resets = <0x8 0x113 0x8 0x117 0x8 0x119>;
        reset-names = "axi", "ahb", "dclk";
        power-domains = <0x16 0x12>;
        iommus = <0xA5>;
        status = "okay";
        assigned-clocks = <0x8 0xB7>;
        assigned-clock-parents = <0x8 0x4>;
        port {
            #address-cells = <0x1>;
            #size-cells = <0x0>;
            phandle = <0xC1>;
            endpoint@0 {
                reg = <0x0>;
                remote-endpoint = <0xA6>;
                phandle = <0xBA>;
            };
            endpoint@1 {
                reg = <0x1>;
                remote-endpoint = <0xA7>;
                phandle = <0xBF>;
            };
            endpoint@2 {
                reg = <0x2>;
                remote-endpoint = <0xA8>;
                phandle = <0xB8>;
            };
            endpoint@3 {
                reg = <0x3>;
                remote-endpoint = <0xA9>;
                phandle = <0x2E>;
            };
            endpoint@4 {
                reg = <0x4>;
                remote-endpoint = <0xAA>;
                phandle = <0xBC>;
            };
        };
    };
    voppwm@ff8f01a0 {
        compatible = "rockchip,vop-pwm";
        reg = <0x0 0xFF8F01A0 0x0 0x10>;
        #pwm-cells = <0x3>;
        pinctrl-names = "active";
        pinctrl-0 = <0xAB>;
        clocks = <0x8 0x6C>;
        clock-names = "pwm";
        status = "disabled";
    };
    iommu@ff8f3f00 {
        compatible = "rockchip,iommu";
        reg = <0x0 0xFF8F3F00 0x0 0x100>;
        interrupts = <0x0 0x77 0x4 0x0>;
        interrupt-names = "vopl_mmu";
        clocks = <0x8 0xDB 0x8 0x1DB>;
        clock-names = "aclk", "hclk";
        power-domains = <0x16 0x12>;
        #iommu-cells = <0x0>;
        status = "okay";
        phandle = <0xA5>;
    };
    vop@ff900000 {
        compatible = "rockchip,rk3399-vop-big";
        reg = <0x0 0xFF900000 0x0 0x600 0x0 0xFF901C00 0x0 0x200 0x0 0xFF902000 0x0 0x1000>;
        reg-names = "regs", "cabc_lut", "gamma_lut";
        interrupts = <0x0 0x76 0x4 0x0>;
        clocks = <0x8 0xD9 0x8 0xB4 0x8 0x1D9 0x8 0xB6>;
        clock-names = "aclk_vop", "dclk_vop", "hclk_vop", "dclk_source";
        resets = <0x8 0x112 0x8 0x116 0x8 0x118>;
        reset-names = "axi", "ahb", "dclk";
        power-domains = <0x16 0x11>;
        iommus = <0xAC>;
        status = "okay";
        assigned-clocks = <0x8 0xB6>;
        assigned-clock-parents = <0x8 0x7>;
        port {
            #address-cells = <0x1>;
            #size-cells = <0x0>;
            phandle = <0xC0>;
            endpoint@0 {
                reg = <0x0>;
                remote-endpoint = <0xAD>;
                phandle = <0xBE>;
            };
            endpoint@1 {
                reg = <0x1>;
                remote-endpoint = <0xAE>;
                phandle = <0xB9>;
            };
            endpoint@2 {
                reg = <0x2>;
                remote-endpoint = <0xAF>;
                phandle = <0xB7>;
            };
            endpoint@3 {
                reg = <0x3>;
                remote-endpoint = <0xB0>;
                phandle = <0x2D>;
            };
            endpoint@4 {
                reg = <0x4>;
                remote-endpoint = <0xB1>;
                phandle = <0xBB>;
            };
        };
    };
    voppwm@ff9001a0 {
        compatible = "rockchip,vop-pwm";
        reg = <0x0 0xFF9001A0 0x0 0x10>;
        #pwm-cells = <0x3>;
        pinctrl-names = "active";
        pinctrl-0 = <0xB2>;
        clocks = <0x8 0x6B>;
        clock-names = "pwm";
        status = "disabled";
    };
    iommu@ff903f00 {
        compatible = "rockchip,iommu";
        reg = <0x0 0xFF903F00 0x0 0x100>;
        interrupts = <0x0 0x76 0x4 0x0>;
        interrupt-names = "vopb_mmu";
        clocks = <0x8 0xD9 0x8 0x1D9>;
        clock-names = "aclk", "hclk";
        power-domains = <0x16 0x11>;
        #iommu-cells = <0x0>;
        status = "okay";
        phandle = <0xAC>;
    };
    rkisp1@ff910000 {
        compatible = "rockchip,rk3399-rkisp1";
        reg = <0x0 0xFF910000 0x0 0x4000>;
        interrupts = <0x0 0x2B 0x4 0x0>;
        clocks = <0x8 0x6E 0x8 0xE5 0x8 0x1DF 0x8 0xE9 0x8 0x1E3>;
        clock-names = "clk_isp", "aclk_isp", "hclk_isp", "aclk_isp_wrap", "hclk_isp_wrap";
        devfreq = <0xB3>;
        power-domains = <0x16 0x13>;
        iommus = <0xB4>;
        status = "disabled";
    };
    iommu@ff914000 {
        compatible = "rockchip,iommu";
        reg = <0x0 0xFF914000 0x0 0x100 0x0 0xFF915000 0x0 0x100>;
        interrupts = <0x0 0x2B 0x4 0x0>;
        interrupt-names = "isp0_mmu";
        #iommu-cells = <0x0>;
        clocks = <0x8 0xE7 0x8 0x1E1>;
        clock-names = "aclk", "hclk";
        power-domains = <0x16 0x13>;
        rk_iommu,disable_reset_quirk;
        status = "okay";
        phandle = <0xB4>;
    };
    rkisp1@ff920000 {
        compatible = "rockchip,rk3399-rkisp1";
        reg = <0x0 0xFF920000 0x0 0x4000>;
        interrupts = <0x0 0x2C 0x4 0x0>;
        clocks = <0x8 0x6F 0x8 0xE6 0x8 0x1E0 0x8 0xEA 0x8 0x1E4>;
        clock-names = "clk_isp", "aclk_isp", "hclk_isp", "aclk_isp_wrap", "hclk_isp_wrap";
        devfreq = <0xB3>;
        power-domains = <0x16 0x14>;
        iommus = <0xB5>;
        status = "disabled";
    };
    iommu@ff924000 {
        compatible = "rockchip,iommu";
        reg = <0x0 0xFF924000 0x0 0x100 0x0 0xFF925000 0x0 0x100>;
        interrupts = <0x0 0x2C 0x4 0x0>;
        interrupt-names = "isp1_mmu";
        #iommu-cells = <0x0>;
        clocks = <0x8 0xE8 0x8 0x1E2>;
        clock-names = "aclk", "hclk";
        power-domains = <0x16 0x14>;
        rk_iommu,disable_reset_quirk;
        status = "okay";
        phandle = <0xB5>;
    };
    hdmi@ff940000 {
        compatible = "rockchip,rk3399-dw-hdmi";
        reg = <0x0 0xFF940000 0x0 0x20000>;
        reg-io-width = <0x4>;
        rockchip,grf = <0x15>;
        pinctrl-names = "default";
        pinctrl-0 = <0xB6>;
        power-domains = <0x16 0x15>;
        interrupts = <0x0 0x17 0x4 0x0>;
        clocks = <0x8 0x174 0x8 0x71 0x8 0x7 0x8 0x16F 0x8 0x70>;
        clock-names = "iahb", "isfr", "vpll", "grf", "cec";
        status = "okay";
        #address-cells = <0x1>;
        #size-cells = <0x0>;
        #sound-dai-cells = <0x0>;
        ddc-i2c-scl-high-time-ns = <0x2599>;
        ddc-i2c-scl-low-time-ns = <0x2710>;
        phandle = <0xE1>;
        ports {
            port {
                #address-cells = <0x1>;
                #size-cells = <0x0>;
                endpoint@0 {
                    reg = <0x0>;
                    remote-endpoint = <0xB7>;
                    status = "okay";
                    phandle = <0xAF>;
                };
                endpoint@1 {
                    reg = <0x1>;
                    remote-endpoint = <0xB8>;
                    status = "disabled";
                    phandle = <0xA8>;
                };
            };
        };
    };
    dsi@ff960000 {
        compatible = "rockchip,rk3399-mipi-dsi";
        reg = <0x0 0xFF960000 0x0 0x8000>;
        interrupts = <0x0 0x2D 0x4 0x0>;
        clocks = <0x8 0xA2 0x8 0x170 0x8 0xA3>;
        clock-names = "ref", "pclk", "phy_cfg";
        resets = <0x8 0xFB>;
        reset-names = "apb";
        power-domains = <0x16 0xF>;
        rockchip,grf = <0x15>;
        #address-cells = <0x1>;
        #size-cells = <0x0>;
        status = "disabled";
        ports {
            port {
                #address-cells = <0x1>;
                #size-cells = <0x0>;
                endpoint@0 {
                    reg = <0x0>;
                    remote-endpoint = <0xB9>;
                    phandle = <0xAE>;
                };
                endpoint@1 {
                    reg = <0x1>;
                    remote-endpoint = <0xBA>;
                    phandle = <0xA6>;
                };
            };
        };
    };
    dsi@ff968000 {
        compatible = "rockchip,rk3399-mipi-dsi";
        reg = <0x0 0xFF968000 0x0 0x8000>;
        interrupts = <0x0 0x2E 0x4 0x0>;
        clocks = <0x8 0xA2 0x8 0x171 0x8 0xA4>;
        clock-names = "ref", "pclk", "phy_cfg";
        resets = <0x8 0xFC>;
        reset-names = "apb";
        power-domains = <0x16 0xF>;
        rockchip,grf = <0x15>;
        #address-cells = <0x1>;
        #size-cells = <0x0>;
        status = "disabled";
        ports {
            port {
                #address-cells = <0x1>;
                #size-cells = <0x0>;
                endpoint@0 {
                    reg = <0x0>;
                    remote-endpoint = <0xBB>;
                    phandle = <0xB1>;
                };
                endpoint@1 {
                    reg = <0x1>;
                    remote-endpoint = <0xBC>;
                    phandle = <0xAA>;
                };
            };
        };
    };
    edp@ff970000 {
        compatible = "rockchip,rk3399-edp";
        reg = <0x0 0xFF970000 0x0 0x8000>;
        interrupts = <0x0 0xA 0x4 0x0>;
        clocks = <0x8 0x16A 0x8 0x16C>;
        clock-names = "dp", "pclk";
        power-domains = <0x16 0x19>;
        resets = <0x8 0x11D>;
        reset-names = "dp";
        rockchip,grf = <0x15>;
        status = "disabled";
        pinctrl-names = "default";
        pinctrl-0 = <0xBD>;
        ports {
            #address-cells = <0x1>;
            #size-cells = <0x0>;
            port@0 {
                reg = <0x0>;
                #address-cells = <0x1>;
                #size-cells = <0x0>;
                endpoint@0 {
                    reg = <0x0>;
                    remote-endpoint = <0xBE>;
                    phandle = <0xAD>;
                };
                endpoint@1 {
                    reg = <0x1>;
                    remote-endpoint = <0xBF>;
                    phandle = <0xA7>;
                };
            };
        };
    };
    hdmi-hdcp2@ff988000 {
        compatible = "rockchip,rk3399-hdmi-hdcp2";
        reg = <0x0 0xFF988000 0x0 0x2000>;
        interrupts = <0x0 0x16 0x4 0x0>;
        clocks = <0x8 0xE0 0x8 0x176 0x8 0x1E9>;
        clock-names = "aclk_hdcp2", "pclk_hdcp2", "hdcp2_clk_hdmi";
        status = "disabled";
    };
    display-subsystem {
        compatible = "rockchip,display-subsystem";
        ports = <0xC0 0xC1>;
        clocks = <0x8 0x7 0x8 0x4>;
        clock-names = "hdmi-tmds-pll", "default-vop-pll";
        devfreq = <0xB3>;
        status = "okay";
        logo-memory-region = <0xC2>;
        secure-memory-region = <0xC3>;
        route {
            route-hdmi {
                overscan,bottom_margin = <0x64>;
                overscan,top_margin = <0x64>;
                overscan,right_margin = <0x64>;
                overscan,left_margin = <0x64>;
                video,flags = <0x0>;
                video,vrefresh = <0x0>;
                video,crtc_vsync_end = <0x0>;
                video,crtc_hsync_end = <0x0>;
                video,vdisplay = <0x0>;
                video,hdisplay = <0x0>;
                logo,ymirror = <0x0>;
                logo,bpp = <0x10>;
                logo,height = <0x102>;
                logo,width = <0x28E>;
                logo,offset = <0x53000>;
                status = "okay";
                logo,uboot = "logo.bmp";
                logo,kernel = "logo_kernel.bmp";
                logo,mode = "center";
                charge_logo,mode = "center";
                connect = <0xB7>;
            };
            route-dsi {
                status = "disabled";
                logo,uboot = "logo.bmp";
                logo,kernel = "logo_kernel.bmp";
                logo,mode = "center";
                charge_logo,mode = "center";
                connect = <0xB9>;
            };
            route-dsi1 {
                status = "disabled";
                logo,uboot = "logo.bmp";
                logo,kernel = "logo_kernel.bmp";
                logo,mode = "center";
                charge_logo,mode = "center";
                connect = <0xBC>;
            };
            route-edp {
                status = "disabled";
                logo,uboot = "logo.bmp";
                logo,kernel = "logo_kernel.bmp";
                logo,mode = "center";
                charge_logo,mode = "center";
                connect = <0xBE>;
            };
        };
    };
    nocp-cci-msch0@ffa86000 {
        compatible = "rockchip,rk3399-nocp";
        reg = <0x0 0xFFA86000 0x0 0x400>;
    };
    nocp-gpu-msch0@ffa86400 {
        compatible = "rockchip,rk3399-nocp";
        reg = <0x0 0xFFA86400 0x0 0x400>;
    };
    nocp-hp-msch0@ffa86800 {
        compatible = "rockchip,rk3399-nocp";
        reg = <0x0 0xFFA86800 0x0 0x400>;
    };
    nocp-lp-msch0@ffa86c00 {
        compatible = "rockchip,rk3399-nocp";
        reg = <0x0 0xFFA86C00 0x0 0x400>;
    };
    nocp-video-msch0@ffa87000 {
        compatible = "rockchip,rk3399-nocp";
        reg = <0x0 0xFFA87000 0x0 0x400>;
    };
    nocp-vio0-msch0@ffa87400 {
        compatible = "rockchip,rk3399-nocp";
        reg = <0x0 0xFFA87400 0x0 0x400>;
    };
    nocp-vio1-msch0@ffa87800 {
        compatible = "rockchip,rk3399-nocp";
        reg = <0x0 0xFFA87800 0x0 0x400>;
    };
    nocp-cci-msch1@ffa8e000 {
        compatible = "rockchip,rk3399-nocp";
        reg = <0x0 0xFFA8E000 0x0 0x400>;
    };
    nocp-gpu-msch1@ffa8e400 {
        compatible = "rockchip,rk3399-nocp";
        reg = <0x0 0xFFA8E400 0x0 0x400>;
    };
    nocp-hp-msch1@ffa8e800 {
        compatible = "rockchip,rk3399-nocp";
        reg = <0x0 0xFFA8E800 0x0 0x400>;
    };
    nocp-lp-msch1@ffa8ec00 {
        compatible = "rockchip,rk3399-nocp";
        reg = <0x0 0xFFA8EC00 0x0 0x400>;
    };
    nocp-video-msch1@ffa8f000 {
        compatible = "rockchip,rk3399-nocp";
        reg = <0x0 0xFFA8F000 0x0 0x400>;
    };
    nocp-vio0-msch1@ffa8f400 {
        compatible = "rockchip,rk3399-nocp";
        reg = <0x0 0xFFA8F400 0x0 0x400>;
    };
    nocp-vio1-msch1@ffa8f800 {
        compatible = "rockchip,rk3399-nocp";
        reg = <0x0 0xFFA8F800 0x0 0x400>;
    };
    pinctrl {
        compatible = "rockchip,rk3399-pinctrl";
        rockchip,grf = <0x15>;
        rockchip,pmu = <0x92>;
        #address-cells = <0x2>;
        #size-cells = <0x2>;
        ranges;
        gpio0@ff720000 {
            compatible = "rockchip,gpio-bank";
            reg = <0x0 0xFF720000 0x0 0x100>;
            clocks = <0x2F 0x17>;
            interrupts = <0x0 0xE 0x4 0x0>;
            gpio-controller;
            #gpio-cells = <0x2>;
            interrupt-controller;
            #interrupt-cells = <0x2>;
            phandle = <0x3C>;
        };
        gpio1@ff730000 {
            compatible = "rockchip,gpio-bank";
            reg = <0x0 0xFF730000 0x0 0x100>;
            clocks = <0x2F 0x18>;
            interrupts = <0x0 0xF 0x4 0x0>;
            gpio-controller;
            #gpio-cells = <0x2>;
            interrupt-controller;
            #interrupt-cells = <0x2>;
            phandle = <0x33>;
        };
        gpio2@ff780000 {
            compatible = "rockchip,gpio-bank";
            reg = <0x0 0xFF780000 0x0 0x100>;
            clocks = <0x8 0x150>;
            interrupts = <0x0 0x10 0x4 0x0>;
            gpio-controller;
            #gpio-cells = <0x2>;
            interrupt-controller;
            #interrupt-cells = <0x2>;
            phandle = <0x52>;
        };
        gpio3@ff788000 {
            compatible = "rockchip,gpio-bank";
            reg = <0x0 0xFF788000 0x0 0x100>;
            clocks = <0x8 0x151>;
            interrupts = <0x0 0x11 0x4 0x0>;
            gpio-controller;
            #gpio-cells = <0x2>;
            interrupt-controller;
            #interrupt-cells = <0x2>;
            phandle = <0x18>;
        };
        gpio4@ff790000 {
            compatible = "rockchip,gpio-bank";
            reg = <0x0 0xFF790000 0x0 0x100>;
            clocks = <0x8 0x152>;
            interrupts = <0x0 0x12 0x4 0x0>;
            gpio-controller;
            #gpio-cells = <0x2>;
            interrupt-controller;
            #interrupt-cells = <0x2>;
            phandle = <0x89>;
        };
        pcfg-pull-up {
            bias-pull-up;
            phandle = <0xC4>;
        };
        pcfg-pull-down {
            bias-pull-down;
            phandle = <0xC8>;
        };
        pcfg-pull-none {
            bias-disable;
            phandle = <0xC6>;
        };
        pcfg-pull-up-20ma {
            bias-pull-up;
            drive-strength = <0x14>;
        };
        pcfg-pull-none-20ma {
            bias-disable;
            drive-strength = <0x14>;
        };
        pcfg-pull-none-18ma {
            bias-disable;
            drive-strength = <0x12>;
        };
        pcfg-pull-none-12ma {
            bias-disable;
            drive-strength = <0xC>;
            phandle = <0xC7>;
        };
        pcfg-pull-up-8ma {
            bias-pull-up;
            drive-strength = <0x8>;
        };
        pcfg-pull-down-4ma {
            bias-pull-down;
            drive-strength = <0x4>;
        };
        pcfg-pull-up-2ma {
            bias-pull-up;
            drive-strength = <0x2>;
        };
        pcfg-pull-down-12ma {
            bias-pull-down;
            drive-strength = <0xC>;
        };
        pcfg-pull-none-13ma {
            bias-disable;
            drive-strength = <0xD>;
            phandle = <0xC5>;
        };
        pcfg-output-high {
            output-high;
        };
        pcfg-output-low {
            output-low;
        };
        pcfg-input {
            input-enable;
        };
        emmc {
            emmc-pwr {
                rockchip,pins = <0x0 0x5 0x1 0xC4>;
            };
        };
        gmac {
            rgmii-pins {
                rockchip,pins = <0x3 0x11 0x1 0xC5 0x3 0xE 0x1 0xC6 0x3 0xD 0x1 0xC6 0x3 0xC 0x1 0xC5 0x3 0xB 0x1 0xC6 0x3 0x9 0x1 0xC6 0x3 0x8 0x1 0xC6 0x3 0x7 0x1 0xC6 0x3 0x6 0x1 0xC6 0x3 0x5 0x1 0xC5 0x3 0x4 0x1 0xC5 0x3 0x3 0x1 0xC6 0x3 0x2 0x1 0xC6 0x3 0x1 0x1 0xC5 0x3 0x0 0x1 0xC5>;
                phandle = <0x1A>;
            };
            rmii-pins {
                rockchip,pins = <0x3 0xD 0x1 0xC6 0x3 0xC 0x1 0xC5 0x3 0xB 0x1 0xC6 0x3 0xA 0x1 0xC6 0x3 0x9 0x1 0xC6 0x3 0x8 0x1 0xC6 0x3 0x7 0x1 0xC6 0x3 0x6 0x1 0xC6 0x3 0x5 0x1 0xC5 0x3 0x4 0x1 0xC5>;
            };
            gmac-reset {
                rockchip,pins = <0x3 0xF 0x0 0xC4>;
            };
        };
        i2c0 {
            i2c0-xfer {
                rockchip,pins = <0x1 0xF 0x2 0xC6 0x1 0x10 0x2 0xC6>;
                phandle = <0x30>;
            };
        };
        i2c1 {
            i2c1-xfer {
                rockchip,pins = <0x4 0x2 0x1 0xC6 0x4 0x1 0x1 0xC6>;
                phandle = <0x39>;
            };
        };
        i2c2 {
            i2c2-xfer {
                rockchip,pins = <0x2 0x1 0x2 0xC7 0x2 0x0 0x2 0xC7>;
                phandle = <0x3D>;
            };
        };
        i2c3 {
            i2c3-xfer {
                rockchip,pins = <0x4 0x11 0x1 0xC6 0x4 0x10 0x1 0xC6>;
                phandle = <0x3E>;
            };
            i2c3_gpio {
                rockchip,pins = <0x4 0x11 0x0 0xC6 0x4 0x10 0x0 0xC6>;
            };
        };
        i2c4 {
            i2c4-xfer {
                rockchip,pins = <0x1 0xC 0x1 0xC6 0x1 0xB 0x1 0xC6>;
                phandle = <0x84>;
            };
        };
        i2c5 {
            i2c5-xfer {
                rockchip,pins = <0x3 0xB 0x2 0xC6 0x3 0xA 0x2 0xC6>;
                phandle = <0x3F>;
            };
        };
        i2c6 {
            i2c6-xfer {
                rockchip,pins = <0x2 0xA 0x2 0xC6 0x2 0x9 0x2 0xC6>;
                phandle = <0x41>;
            };
        };
        i2c7 {
            i2c7-xfer {
                rockchip,pins = <0x2 0x8 0x2 0xC6 0x2 0x7 0x2 0xC6>;
                phandle = <0x42>;
            };
        };
        i2c8 {
            i2c8-xfer {
                rockchip,pins = <0x1 0x15 0x1 0xC6 0x1 0x14 0x1 0xC6>;
                phandle = <0x8A>;
            };
        };
        i2s0 {
            i2s0-8ch-bus {
                rockchip,pins = <0x3 0x18 0x1 0xC6 0x3 0x19 0x1 0xC6 0x3 0x1A 0x1 0xC6 0x3 0x1B 0x1 0xC6 0x3 0x1C 0x1 0xC6 0x3 0x1D 0x1 0xC6 0x3 0x1E 0x1 0xC6 0x3 0x1F 0x1 0xC6>;
                phandle = <0xA1>;
            };
            i2s-8ch-mclk {
                rockchip,pins = <0x4 0x0 0x1 0xC6>;
                phandle = <0x3A>;
            };
            i2s0-5ch-bus {
                rockchip,pins = <0x3 0x18 0x1 0xC6 0x3 0x19 0x1 0xC6 0x3 0x1A 0x1 0xC6 0x3 0x1B 0x1 0xC6 0x3 0x1F 0x1 0xC6>;
                phandle = <0x3B>;
            };
        };
        i2s1 {
            i2s1-2ch-bus {
                rockchip,pins = <0x4 0x3 0x1 0xC6 0x4 0x4 0x1 0xC6 0x4 0x5 0x1 0xC6 0x4 0x6 0x1 0xC6 0x4 0x7 0x1 0xC6>;
                phandle = <0xA2>;
            };
        };
        sdio0 {
            sdio0-bus1 {
                rockchip,pins = <0x2 0x14 0x1 0xC4>;
            };
            sdio0-bus4 {
                rockchip,pins = <0x2 0x14 0x1 0xC4 0x2 0x15 0x1 0xC4 0x2 0x16 0x1 0xC4 0x2 0x17 0x1 0xC4>;
                phandle = <0x1C>;
            };
            sdio0-cmd {
                rockchip,pins = <0x2 0x18 0x1 0xC4>;
                phandle = <0x1D>;
            };
            sdio0-clk {
                rockchip,pins = <0x2 0x19 0x1 0xC6>;
                phandle = <0x1E>;
            };
            sdio0-cd {
                rockchip,pins = <0x2 0x1A 0x1 0xC4>;
            };
            sdio0-pwr {
                rockchip,pins = <0x2 0x1B 0x1 0xC4>;
            };
            sdio0-bkpwr {
                rockchip,pins = <0x2 0x1C 0x1 0xC4>;
            };
            sdio0-wp {
                rockchip,pins = <0x0 0x3 0x1 0xC4>;
            };
            sdio0-int {
                rockchip,pins = <0x0 0x4 0x1 0xC4>;
            };
        };
        sdmmc {
            sdmmc-bus1 {
                rockchip,pins = <0x4 0x8 0x1 0xC4>;
            };
            sdmmc-bus4 {
                rockchip,pins = <0x4 0x8 0x1 0xC4 0x4 0x9 0x1 0xC4 0x4 0xA 0x1 0xC4 0x4 0xB 0x1 0xC4>;
                phandle = <0x23>;
            };
            sdmmc-clk {
                rockchip,pins = <0x4 0xC 0x1 0xC6>;
                phandle = <0x20>;
            };
            sdmmc-cmd {
                rockchip,pins = <0x4 0xD 0x1 0xC4>;
                phandle = <0x21>;
            };
            sdmcc-cd {
                rockchip,pins = <0x0 0x7 0x1 0xC4>;
                phandle = <0x22>;
            };
            sdmmc-wp {
                rockchip,pins = <0x0 0x8 0x1 0xC4>;
            };
        };
        spdif {
            spdif-bus {
                rockchip,pins = <0x4 0x15 0x1 0xC6>;
                phandle = <0xA0>;
            };
            spdif-bus-1 {
                rockchip,pins = <0x3 0x10 0x3 0xC6>;
            };
        };
        spi0 {
            spi0-clk {
                rockchip,pins = <0x3 0x6 0x2 0xC4>;
                phandle = <0x49>;
            };
            spi0-cs0 {
                rockchip,pins = <0x3 0x7 0x2 0xC4>;
                phandle = <0x4C>;
            };
            spi0-cs1 {
                rockchip,pins = <0x3 0x8 0x2 0xC4>;
            };
            spi0-tx {
                rockchip,pins = <0x3 0x5 0x2 0xC4>;
                phandle = <0x4A>;
            };
            spi0-rx {
                rockchip,pins = <0x3 0x4 0x2 0xC4>;
                phandle = <0x4B>;
            };
        };
        spi1 {
            spi1-clk {
                rockchip,pins = <0x1 0x9 0x2 0xC4>;
                phandle = <0x4D>;
            };
            spi1-cs0 {
                rockchip,pins = <0x1 0xA 0x2 0xC4>;
                phandle = <0x50>;
            };
            spi1-rx {
                rockchip,pins = <0x1 0x7 0x2 0xC4>;
                phandle = <0x4F>;
            };
            spi1-tx {
                rockchip,pins = <0x1 0x8 0x2 0xC4>;
                phandle = <0x4E>;
            };
        };
        spi2 {
            spi2-clk {
                rockchip,pins = <0x2 0xB 0x1 0xC4>;
                phandle = <0x53>;
            };
            spi2-cs0 {
                rockchip,pins = <0x2 0xC 0x1 0xC4>;
                phandle = <0x56>;
            };
            spi2-rx {
                rockchip,pins = <0x2 0x9 0x1 0xC4>;
                phandle = <0x55>;
            };
            spi2-tx {
                rockchip,pins = <0x2 0xA 0x1 0xC4>;
                phandle = <0x54>;
            };
        };
        spi3 {
            spi3-clk {
                rockchip,pins = <0x1 0x11 0x1 0xC4>;
                phandle = <0x7F>;
            };
            spi3-cs0 {
                rockchip,pins = <0x1 0x12 0x1 0xC4>;
                phandle = <0x82>;
            };
            spi3-rx {
                rockchip,pins = <0x1 0xF 0x1 0xC4>;
                phandle = <0x81>;
            };
            spi3-tx {
                rockchip,pins = <0x1 0x10 0x1 0xC4>;
                phandle = <0x80>;
            };
        };
        spi4 {
            spi4-clk {
                rockchip,pins = <0x3 0x2 0x2 0xC4>;
                phandle = <0x57>;
            };
            spi4-cs0 {
                rockchip,pins = <0x3 0x3 0x2 0xC4>;
                phandle = <0x5A>;
            };
            spi4-rx {
                rockchip,pins = <0x3 0x0 0x2 0xC4>;
                phandle = <0x59>;
            };
            spi4-tx {
                rockchip,pins = <0x3 0x1 0x2 0xC4>;
                phandle = <0x58>;
            };
        };
        spi5 {
            spi5-clk {
                rockchip,pins = <0x2 0x16 0x2 0xC4>;
                phandle = <0x5C>;
            };
            spi5-cs0 {
                rockchip,pins = <0x2 0x17 0x2 0xC4>;
                phandle = <0x5F>;
            };
            spi5-rx {
                rockchip,pins = <0x2 0x14 0x2 0xC4>;
                phandle = <0x5E>;
            };
            spi5-tx {
                rockchip,pins = <0x2 0x15 0x2 0xC4>;
                phandle = <0x5D>;
            };
        };
        tsadc {
            otp-gpio {
                rockchip,pins = <0x1 0x6 0x0 0xC6>;
                phandle = <0x63>;
            };
            otp-out {
                rockchip,pins = <0x1 0x6 0x1 0xC6>;
                phandle = <0x64>;
            };
        };
        uart0 {
            uart0-xfer {
                rockchip,pins = <0x2 0x10 0x1 0xC4 0x2 0x11 0x1 0xC6>;
                phandle = <0x43>;
            };
            uart0-cts {
                rockchip,pins = <0x2 0x12 0x1 0xC6>;
                phandle = <0x44>;
            };
            uart0-rts {
                rockchip,pins = <0x2 0x13 0x1 0xC6>;
                phandle = <0xE5>;
            };
        };
        uart1 {
            uart1-xfer {
                rockchip,pins = <0x3 0xC 0x2 0xC4 0x3 0xD 0x2 0xC6>;
                phandle = <0x45>;
            };
        };
        uart2a {
            uart2a-xfer {
                rockchip,pins = <0x4 0x8 0x2 0xC4 0x4 0x9 0x2 0xC6>;
            };
        };
        uart2b {
            uart2b-xfer {
                rockchip,pins = <0x4 0x10 0x2 0xC4 0x4 0x11 0x2 0xC6>;
            };
        };
        uart2c {
            uart2c-xfer {
                rockchip,pins = <0x4 0x13 0x1 0xC4 0x4 0x14 0x1 0xC6>;
                phandle = <0x46>;
            };
        };
        uart3 {
            uart3-xfer {
                rockchip,pins = <0x3 0xE 0x2 0xC4 0x3 0xF 0x2 0xC6>;
                phandle = <0x47>;
            };
            uart3-cts {
                rockchip,pins = <0x3 0x10 0x2 0xC6>;
            };
            uart3-rts {
                rockchip,pins = <0x3 0x11 0x2 0xC6>;
            };
        };
        uart4 {
            uart4-xfer {
                rockchip,pins = <0x1 0x7 0x1 0xC4 0x1 0x8 0x1 0xC6>;
                phandle = <0x83>;
            };
        };
        uarthdcp {
            uarthdcp-xfer {
                rockchip,pins = <0x4 0x15 0x2 0xC4 0x4 0x16 0x2 0xC6>;
            };
        };
        pwm0 {
            pwm0-pin {
                rockchip,pins = <0x4 0x12 0x1 0xC6>;
                phandle = <0x8E>;
            };
            vop0-pwm-pin {
                rockchip,pins = <0x4 0x12 0x2 0xC6>;
                phandle = <0xB2>;
            };
            vop1-pwm-pin {
                rockchip,pins = <0x4 0x12 0x3 0xC6>;
                phandle = <0xAB>;
            };
        };
        pwm1 {
            pwm1-pin {
                rockchip,pins = <0x4 0x16 0x1 0xC6>;
                phandle = <0x8F>;
            };
        };
        pwm2 {
            pwm2-pin {
                rockchip,pins = <0x1 0x13 0x1 0xC6>;
                phandle = <0x90>;
            };
        };
        pwm3a {
            pwm3a-pin {
                rockchip,pins = <0x0 0x6 0x1 0xC6>;
                phandle = <0x91>;
            };
        };
        pwm3b {
            pwm3b-pin {
                rockchip,pins = <0x1 0xE 0x1 0xC6>;
            };
        };
        edp {
            edp-hpd {
                rockchip,pins = <0x4 0x17 0x2 0xC6>;
                phandle = <0xBD>;
            };
        };
        hdmi {
            hdmi-i2c-xfer {
                rockchip,pins = <0x4 0x11 0x3 0xC6 0x4 0x10 0x3 0xC6>;
                phandle = <0xB6>;
            };
            hdmi-cec {
                rockchip,pins = <0x4 0x17 0x1 0xC6>;
            };
        };
        pcie {
            pci-clkreqn {
                rockchip,pins = <0x2 0x1A 0x2 0xC6>;
            };
            pci-clkreqnb {
                rockchip,pins = <0x4 0x18 0x1 0xC6>;
            };
            pci-clkreqn-cpm {
                rockchip,pins = <0x2 0x1A 0x0 0xC6>;
            };
            pci-clkreqnb-cpm {
                rockchip,pins = <0x4 0x18 0x0 0xC6>;
            };
        };
        isp {
            cif-clkout {
                rockchip,pins = <0x2 0xB 0x3 0xC6>;
                phandle = <0xCC>;
            };
            isp-dvp-d0d7 {
                rockchip,pins = <0x2 0x0 0x3 0xC6 0x2 0x1 0x3 0xC6 0x2 0x2 0x3 0xC6 0x2 0x3 0x3 0xC6 0x2 0x4 0x3 0xC6 0x2 0x5 0x3 0xC6 0x2 0x6 0x3 0xC6 0x2 0x7 0x3 0xC6 0x2 0x8 0x3 0xC6 0x2 0x9 0x3 0xC6 0x2 0xA 0x3 0xC6>;
                phandle = <0xCD>;
            };
            isp-shutter {
                rockchip,pins = <0x1 0x1 0x1 0xC6 0x1 0x0 0x1 0xC6>;
            };
            isp-flash-trigger {
                rockchip,pins = <0x1 0x3 0x1 0xC6>;
                phandle = <0xD0>;
            };
            isp-prelight {
                rockchip,pins = <0x1 0x4 0x1 0xC6>;
                phandle = <0xCE>;
            };
            isp_flash_trigger_as_gpio {
                rockchip,pins = <0x1 0x3 0x0 0xC6>;
                phandle = <0xCF>;
            };
        };
        sdio-pwrseq {
            wifi-enable-h {
                rockchip,pins = <0x0 0xA 0x0 0xC6>;
                phandle = <0xE4>;
            };
        };
        wireless-bluetooth {
            uart0-gpios {
                rockchip,pins = <0x2 0x13 0x0 0xC6>;
                phandle = <0xE6>;
            };
        };
        pmic {
            pmic-int-l {
                rockchip,pins = <0x1 0x15 0x0 0xC4>;
                phandle = <0x35>;
            };
            pmic-dvs2 {
                rockchip,pins = <0x1 0x12 0x0 0xC8>;
                phandle = <0x36>;
            };
            vsel1-gpio {
                rockchip,pins = <0x1 0x11 0x0 0xC8>;
                phandle = <0x32>;
            };
            vsel2-gpio {
                rockchip,pins = <0x1 0xE 0x0 0xC8>;
                phandle = <0x34>;
            };
        };
        hallsensor {
            mh248-irq-gpio {
                rockchip,pins = <0x1 0x2 0x0 0xC4>;
                phandle = <0xD5>;
            };
        };
        headphone {
            hp-det {
                rockchip,pins = <0x4 0x1C 0x0 0xC4>;
                phandle = <0xE2>;
            };
        };
        lsm330_a {
            lsm330a-irq-gpio {
                rockchip,pins = <0x2 0x1B 0x0 0xC6>;
                phandle = <0x85>;
            };
        };
        lsm330_g {
            lsm330g-irq-gpio {
                rockchip,pins = <0x1 0x14 0x0 0xC6>;
                phandle = <0x86>;
            };
        };
        mpu6500 {
            mpu6500-irq-gpio {
                rockchip,pins = <0x2 0x1B 0x0 0xC6>;
                phandle = <0x51>;
            };
        };
        ak8963 {
            ak8963-irq-gpio {
                rockchip,pins = <0x2 0x1C 0x0 0xC6>;
                phandle = <0x87>;
            };
        };
        cm3218 {
            cm3218-irq-gpio {
                rockchip,pins = <0x4 0x18 0x0 0xC4>;
                phandle = <0x88>;
            };
        };
        usb1 {
            host-vbus-otg-drv {
                rockchip,pins = <0x2 0x7 0x0 0xC6>;
                phandle = <0xD6>;
            };
        };
        usb2 {
            host-vbus-drv {
                rockchip,pins = <0x4 0x1A 0x0 0xC6>;
                phandle = <0xD7>;
            };
        };
        fusb30x {
            fusb0-int {
                rockchip,pins = <0x4 0x18 0x0 0xC4 0x1 0x3 0x0 0xC4>;
            };
        };
        leds {
            leds-gpio {
                rockchip,pins = <0x2 0x4 0x0 0xC4 0x4 0x1B 0x0 0xC4 0x3 0x10 0x0 0xC4 0x1 0x4 0x0 0xC4 0x0 0xC 0x0 0xC4 0x2 0x5 0x0 0xC4 0x4 0x15 0x0 0xC4 0x0 0x2 0x0 0xC4 0x0 0x8 0x0 0xC4 0x4 0x1D 0x0 0xC4>;
                phandle = <0xE7>;
            };
        };
        charger {
            charge-ok {
                rockchip,pins = <0x1 0x17 0x0 0xC4>;
            };
        };
    };
    rockchip-suspend {
        compatible = "rockchip,pm-rk3399";
        status = "okay";
        rockchip,sleep-debug-en = <0x1>;
        rockchip,virtual-poweroff = <0x0>;
        rockchip,sleep-mode-config = <0xFE>;
        rockchip,wakeup-config = <0x804>;
        rockchip,pwm-regulator-config = <0x4>;
        rockchip,power-ctrl = <0x33 0x11 0x0 0x33 0xE 0x0>;
    };
    chosen {
        linux,initrd-end = <0x0 0x4E48028>;
        linux,initrd-start = <0x0 0x4BF0000>;
        bootargs = "earlycon=uart8250,mmio32,0xff1a0000 swiotlb=1 coherent_pool=1m console=ttyFIQ0 androidboot.baseband=N/A androidboot.selinux=permissive androidboot.hardware=rk30board androidboot.console=ttyFIQ0 init=/init mtdparts=rk29xxnand:0x00002000@0x00002000(uboot),0x00002000@0x00004000(trust),0x00002000@0x00006000(misc),0x00008000@0x00008000(resource),0x0000C000@0x00010000(kernel),0x00010000@0x0001C000(boot),0x00010000@0x0002C000(recovery),0x00038000@0x0003C000(backup),0x00040000@0x00074000(cache),0x00600000@0x000B4000(system),0x00008000@0x006B4000(metadata),0x00000040@0x006BC000(verity_mode),0x00002000@0x006BC040(reserved),0x00000400@0x006BE040(frp),0x00002000@0x006BE440(ezrobot),-@0x006C0440(userdata) storagemedia=emmc androidboot.oem_unlocked=0 uboot_logo=0x02000000@0xf5c00000 loader.timestamp=2020-07-07_11:06:38 SecureBootCheckOk=0";
    };
    cpuinfo {
        compatible = "rockchip,cpuinfo";
        nvmem-cells = <0xC9>;
        nvmem-cell-names = "id";
    };
    ramoops_mem {
        reg = <0x0 0x110000 0x0 0xF0000>;
        reg-names = "ramoops_mem";
        phandle = <0xCA>;
    };
    ramoops {
        compatible = "ramoops";
        record-size = <0x0 0x20000>;
        console-size = <0x0 0x80000>;
        ftrace-size = <0x0 0x0>;
        pmsg-size = <0x0 0x50000>;
        memory-region = <0xCA>;
    };
    fiq-debugger {
        compatible = "rockchip,fiq-debugger";
        rockchip,serial-id = <0x2>;
        rockchip,wake-irq = <0x0>;
        rockchip,irq-mode-enable = <0x0>;
        rockchip,baudrate = <0x16E360>;
        pinctrl-names = "default";
        pinctrl-0 = <0x46>;
        interrupts = <0x0 0x96 0x4 0x0>;
    };
    reserved-memory {
        #address-cells = <0x2>;
        #size-cells = <0x2>;
        ranges;
        drm-logo@00000000 {
            compatible = "rockchip,drm-logo";
            reg = <0x0 0xF5C00000 0x0 0xA5638>;
            phandle = <0xC2>;
        };
        secure-memory@20000000 {
            compatible = "rockchip,secure-memory";
            reg = <0x0 0x20000000 0x0 0x10000000>;
            status = "disabled";
            phandle = <0xC3>;
        };
        stb-devinfo@00000000 {
            compatible = "rockchip,stb-devinfo";
            reg = <0x0 0x0 0x0 0x0>;
        };
    };
    rockchip-key {
        compatible = "rockchip,key";
        status = "okay";
        io-channels = <0xCB 0x1>;
        vol-up-key {
            linux,code = <0x72>;
            label = "volume up";
            rockchip,adc_value = <0x0>;
        };
        vol-down-key {
            linux,code = <0x73>;
            label = "volume down";
            rockchip,adc_value = <0x0>;
        };
        power-key {
            gpios = <0x3C 0x5 0x1>;
            linux,code = <0x74>;
            label = "power";
            gpio-key,wakeup;
        };
        menu-key {
            linux,code = <0x3B>;
            label = "menu";
            rockchip,adc_value = <0x0>;
        };
        home-key {
            linux,code = <0x66>;
            label = "home";
            rockchip,adc_value = <0x0>;
        };
        back-key {
            linux,code = <0x9E>;
            label = "back";
            rockchip,adc_value = <0x0>;
        };
        camera-key {
            linux,code = <0xD4>;
            label = "camera";
            rockchip,adc_value = <0x0>;
        };
    };
    isp@ff910000 {
        compatible = "rockchip,rk3399-isp", "rockchip,isp";
        reg = <0x0 0xFF910000 0x0 0x4000>;
        interrupts = <0x0 0x2B 0x4 0x0>;
        assigned-clocks = <0x8 0xB2>;
        assigned-clock-parents = <0x8 0x5>;
        assigned-clock-rates = <0x2FAF0800>;
        clocks = <0x8 0x89 0x8 0xB2 0x8 0xA4 0x8 0x77 0x8 0xE7 0x8 0xE9 0x8 0x1E1 0x8 0x1E3 0x8 0x6E 0x8 0xA5>;
        clock-names = "clk_cif_out", "clk_cif_pll", "pclk_dphytxrx", "pclk_dphy_ref", "aclk_isp0_noc", "aclk_isp0_wrapper", "hclk_isp0_noc", "hclk_isp0_wrapper", "clk_isp0", "pclk_dphyrx";
        pinctrl-names = "cif_clkout", "isp_dvp8bit0", "isp_mipi_fl", "isp_mipi_fl_prefl", "isp_flash_as_gpio", "isp_flash_as_trigger_out";
        pinctrl-0 = <0xCC>;
        pinctrl-1 = <0xCC 0xCD>;
        pinctrl-2 = <0xCC>;
        pinctrl-3 = <0xCC 0xCE>;
        pinctrl-4 = <0xCF>;
        pinctrl-5 = <0xD0>;
        rockchip,isp,mipiphy = <0x2>;
        rockchip,isp,cifphy = <0x1>;
        rockchip,isp,dsiphy,reg = <0xFF968000 0x8000>;
        rockchip,grf = <0x15>;
        rockchip,cru = <0x8>;
        rockchip,gpios = <0x33 0x3 0x0>;
        rockchip,isp,iommu-enable = <0x1>;
        power-domains = <0x16 0x13>;
        iommus = <0xB4>;
        status = "okay";
    };
    isp@ff920000 {
        compatible = "rockchip,rk3399-isp", "rockchip,isp";
        reg = <0x0 0xFF920000 0x0 0x4000>;
        interrupts = <0x0 0x2C 0x4 0x0>;
        clocks = <0x8 0xE8 0x8 0xEA 0x8 0x1E2 0x8 0x1E4 0x8 0x6F 0x8 0x89 0x8 0xB2 0x8 0xA4 0x8 0x77 0x8 0x17B 0x8 0xA5 0x8 0x171 0x8 0x78>;
        clock-names = "aclk_isp1_noc", "aclk_isp1_wrapper", "hclk_isp1_noc", "hclk_isp1_wrapper", "clk_isp1", "clk_cif_out", "clk_cif_pll", "pclk_dphytxrx", "pclk_dphy_ref", "pclk_isp1", "pclk_dphyrx", "pclk_mipi_dsi", "mipi_dphy_cfg";
        pinctrl-names = "cif_clkout", "isp_dvp8bit0", "isp_mipi_fl", "isp_mipi_fl_prefl", "isp_flash_as_gpio", "isp_flash_as_trigger_out";
        pinctrl-0 = <0xCC>;
        pinctrl-1 = <0xCD>;
        pinctrl-2 = <0xCC>;
        pinctrl-3 = <0xCE>;
        pinctrl-4 = <0xCF>;
        pinctrl-5 = <0xD0>;
        rockchip,isp,mipiphy = <0x2>;
        rockchip,isp,cifphy = <0x1>;
        rockchip,isp,dsiphy,reg = <0xFF968000 0x8000>;
        rockchip,grf = <0x15>;
        rockchip,cru = <0x8>;
        rockchip,gpios = <0x33 0x3 0x0>;
        rockchip,isp,iommu-enable = <0x1>;
        power-domains = <0x16 0x14>;
        iommus = <0xB5>;
        status = "okay";
    };
    uboot-charge {
        compatible = "rockchip,uboot-charge";
        rockchip,uboot-charge-on = <0x0>;
        rockchip,android-charge-on = <0x1>;
    };
    firmware {
        android {
            compatible = "android,firmware";
            fstab {
                compatible = "android,fstab";
                system {
                    compatible = "android,system";
                    dev = "/dev/block/platform/fe330000.sdhci/by-name/system";
                    type = "ext4";
                    mnt_flags = "ro,barrier=1,inode_readahead_blks=8";
                    fsmgr_flags = "wait,verify";
                };
                vendor {
                    compatible = "android,vendor";
                    dev = "/dev/block/platform/fe330000.sdhci/by-name/vendor";
                    type = "ext4";
                    mnt_flags = "ro,barrier=1,inode_readahead_blks=8";
                    fsmgr_flags = "wait,verify";
                };
            };
        };
    };
    energy-costs {
        rk3399-core-cost0 {
            busy-cost-data = <0x6C 0x2E 0x9F 0x43 0xD8 0x5A 0x10B 0x78 0x13E 0x99 0x177 0xC6 0x191 0xDE>;
            idle-cost-data = <0x6 0x6 0x0 0x0>;
            phandle = <0xC>;
        };
        rk3399-core-cost1 {
            busy-cost-data = <0xD2 0x81 0x134 0xB8 0x1A3 0xF6 0x206 0x14F 0x269 0x1AC 0x2D8 0x23D 0x33B 0x2D4 0x39D 0x384 0x400 0x454>;
            idle-cost-data = <0xF 0xF 0x0 0x0>;
            phandle = <0x10>;
        };
        rk3399-cluster-cost0 {
            busy-cost-data = <0x6C 0x2E 0x9F 0x43 0xD8 0x5A 0x10B 0x78 0x13E 0x99 0x177 0xC6 0x191 0xDE>;
            idle-cost-data = <0x38 0x38 0x38 0x38>;
            phandle = <0xD>;
        };
        rk3399-cluster-cost1 {
            busy-cost-data = <0xD2 0x81 0x134 0xB8 0x1A3 0xF6 0x206 0x14F 0x269 0x1AC 0x2D8 0x23D 0x33B 0x2D4 0x39D 0x384 0x400 0x454>;
            idle-cost-data = <0x41 0x41 0x41 0x41>;
            phandle = <0x11>;
        };
    };
    opp-table0 {
        compatible = "operating-points-v2";
        opp-shared;
        rockchip,temp-hysteresis = <0x1388>;
        rockchip,low-temp = <0x2710>;
        rockchip,low-temp-min-volt = <0xDBBA0>;
        nvmem-cells = <0xD1 0xD2>;
        nvmem-cell-names = "cpu_leakage", "specification_serial_number";
        clocks = <0x8 0x1>;
        rockchip,avs-scale = <0x14>;
        rockchip,bin-scaling-sel = <0x0 0x1E 0x1 0x22>;
        rockchip,pvtm-voltage-sel = <0x0 0x2308C 0x0 0x2308D 0x24414 0x1 0x24415 0x251C0 0x2 0x251C1 0xF423F 0x3>;
        rockchip,pvtm-freq = <0x639C0>;
        rockchip,pvtm-volt = <0xF4240>;
        rockchip,pvtm-ch = <0x0 0x0>;
        rockchip,pvtm-sample-time = <0x3E8>;
        rockchip,pvtm-number = <0xA>;
        rockchip,pvtm-error = <0x3E8>;
        rockchip,pvtm-ref-temp = <0x29>;
        rockchip,pvtm-temp-prop = <0x73 0x42>;
        rockchip,thermal-zone = "soc-thermal";
        phandle = <0xB>;
        opp-408000000 {
            opp-hz = <0x0 0x18519600>;
            opp-microvolt = <0xC96A8 0xC96A8 0x1312D0>;
            opp-microvolt-L0 = <0xC96A8 0xC96A8 0x1312D0>;
            opp-microvolt-L1 = <0xC96A8 0xC96A8 0x1312D0>;
            opp-microvolt-L2 = <0xC96A8 0xC96A8 0x1312D0>;
            opp-microvolt-L3 = <0xC96A8 0xC96A8 0x1312D0>;
            clock-latency-ns = <0x9C40>;
        };
        opp-600000000 {
            opp-hz = <0x0 0x23C34600>;
            opp-microvolt = <0xC96A8 0xC96A8 0x1312D0>;
            opp-microvolt-L0 = <0xC96A8 0xC96A8 0x1312D0>;
            opp-microvolt-L1 = <0xC96A8 0xC96A8 0x1312D0>;
            opp-microvolt-L2 = <0xC96A8 0xC96A8 0x1312D0>;
            opp-microvolt-L3 = <0xC96A8 0xC96A8 0x1312D0>;
            clock-latency-ns = <0x9C40>;
        };
        opp-816000000 {
            opp-hz = <0x0 0x30A32C00>;
            opp-microvolt = <0xCF850 0xCF850 0x1312D0>;
            opp-microvolt-L0 = <0xCF850 0xCF850 0x1312D0>;
            opp-microvolt-L1 = <0xC96A8 0xC96A8 0x1312D0>;
            opp-microvolt-L2 = <0xC96A8 0xC96A8 0x1312D0>;
            opp-microvolt-L3 = <0xC96A8 0xC96A8 0x1312D0>;
            clock-latency-ns = <0x9C40>;
            opp-suspend;
        };
        opp-1008000000 {
            opp-hz = <0x0 0x3C14DC00>;
            opp-microvolt = <0xE1D48 0xE1D48 0x1312D0>;
            opp-microvolt-L0 = <0xE1D48 0xE1D48 0x1312D0>;
            opp-microvolt-L1 = <0xDBBA0 0xDBBA0 0x1312D0>;
            opp-microvolt-L2 = <0xD59F8 0xD59F8 0x1312D0>;
            opp-microvolt-L3 = <0xCF850 0xCF850 0x1312D0>;
            clock-latency-ns = <0x9C40>;
        };
        opp-1200000000 {
            opp-hz = <0x0 0x47868C00>;
            opp-microvolt = <0xF4240 0xF4240 0x1312D0>;
            opp-microvolt-L0 = <0xF4240 0xF4240 0x1312D0>;
            opp-microvolt-L1 = <0xEE098 0xEE098 0x1312D0>;
            opp-microvolt-L2 = <0xE7EF0 0xE7EF0 0x1312D0>;
            opp-microvolt-L3 = <0xE1D48 0xE1D48 0x1312D0>;
            clock-latency-ns = <0x9C40>;
        };
        opp-1416000000 {
            opp-hz = <0x0 0x54667200>;
            opp-microvolt = <0x112A88 0x112A88 0x1312D0>;
            opp-microvolt-L0 = <0x112A88 0x112A88 0x1312D0>;
            opp-microvolt-L1 = <0x10C8E0 0x10C8E0 0x1312D0>;
            opp-microvolt-L2 = <0x106738 0x106738 0x1312D0>;
            opp-microvolt-L3 = <0x100590 0x100590 0x1312D0>;
            clock-latency-ns = <0x9C40>;
        };
    };
    opp-table1 {
        compatible = "operating-points-v2";
        opp-shared;
        rockchip,temp-hysteresis = <0x1388>;
        rockchip,low-temp = <0x2710>;
        rockchip,low-temp-min-volt = <0xDBBA0>;
        nvmem-cells = <0xD3 0xD2>;
        nvmem-cell-names = "cpu_leakage", "specification_serial_number";
        clocks = <0x8 0x2>;
        rockchip,avs-scale = <0x8>;
        rockchip,bin-scaling-sel = <0x0 0x8 0x1 0x11>;
        rockchip,pvtm-voltage-sel = <0x0 0x24608 0x0 0x24609 0x25D78 0x1 0x25D79 0x27100 0x2 0x27101 0xF423F 0x3>;
        rockchip,pvtm-freq = <0x639C0>;
        rockchip,pvtm-volt = <0xF4240>;
        rockchip,pvtm-ch = <0x1 0x0>;
        rockchip,pvtm-sample-time = <0x3E8>;
        rockchip,pvtm-number = <0xA>;
        rockchip,pvtm-error = <0x3E8>;
        rockchip,pvtm-ref-temp = <0x29>;
        rockchip,pvtm-temp-prop = <0x47 0x23>;
        rockchip,thermal-zone = "soc-thermal";
        phandle = <0xF>;
        opp-408000000 {
            opp-hz = <0x0 0x18519600>;
            opp-microvolt = <0xC96A8 0xC96A8 0x1312D0>;
            opp-microvolt-L0 = <0xC96A8 0xC96A8 0x1312D0>;
            opp-microvolt-L1 = <0xC96A8 0xC96A8 0x1312D0>;
            opp-microvolt-L2 = <0xC96A8 0xC96A8 0x1312D0>;
            opp-microvolt-L3 = <0xC96A8 0xC96A8 0x1312D0>;
            clock-latency-ns = <0x9C40>;
        };
        opp-600000000 {
            opp-hz = <0x0 0x23C34600>;
            opp-microvolt = <0xC96A8 0xC96A8 0x1312D0>;
            opp-microvolt-L0 = <0xC96A8 0xC96A8 0x1312D0>;
            opp-microvolt-L1 = <0xC96A8 0xC96A8 0x1312D0>;
            opp-microvolt-L2 = <0xC96A8 0xC96A8 0x1312D0>;
            opp-microvolt-L3 = <0xC96A8 0xC96A8 0x1312D0>;
            clock-latency-ns = <0x9C40>;
        };
        opp-816000000 {
            opp-hz = <0x0 0x30A32C00>;
            opp-microvolt = <0xC96A8 0xC96A8 0x1312D0>;
            opp-microvolt-L0 = <0xC96A8 0xC96A8 0x1312D0>;
            opp-microvolt-L1 = <0xC96A8 0xC96A8 0x1312D0>;
            opp-microvolt-L2 = <0xC96A8 0xC96A8 0x1312D0>;
            opp-microvolt-L3 = <0xC96A8 0xC96A8 0x1312D0>;
            clock-latency-ns = <0x9C40>;
            opp-suspend;
        };
        opp-1008000000 {
            opp-hz = <0x0 0x3C14DC00>;
            opp-microvolt = <0xD59F8 0xD59F8 0x1312D0>;
            opp-microvolt-L0 = <0xD59F8 0xD59F8 0x1312D0>;
            opp-microvolt-L1 = <0xCF850 0xCF850 0x1312D0>;
            opp-microvolt-L2 = <0xCF850 0xCF850 0x1312D0>;
            opp-microvolt-L3 = <0xCF850 0xCF850 0x1312D0>;
            clock-latency-ns = <0x9C40>;
        };
        opp-1200000000 {
            opp-hz = <0x0 0x47868C00>;
            opp-microvolt = <0xE7EF0 0xE7EF0 0x1312D0>;
            opp-microvolt-L0 = <0xE7EF0 0xE7EF0 0x1312D0>;
            opp-microvolt-L1 = <0xE1D48 0xE1D48 0x1312D0>;
            opp-microvolt-L2 = <0xDBBA0 0xDBBA0 0x1312D0>;
            opp-microvolt-L3 = <0xD59F8 0xD59F8 0x1312D0>;
            clock-latency-ns = <0x9C40>;
        };
        opp-1416000000 {
            opp-hz = <0x0 0x54667200>;
            opp-microvolt = <0xFA3E8 0xFA3E8 0x1312D0>;
            opp-microvolt-L0 = <0xFA3E8 0xFA3E8 0x1312D0>;
            opp-microvolt-L1 = <0xF4240 0xF4240 0x1312D0>;
            opp-microvolt-L2 = <0xF4240 0xF4240 0x1312D0>;
            opp-microvolt-L3 = <0xEE098 0xEE098 0x1312D0>;
            clock-latency-ns = <0x9C40>;
        };
        opp-1608000000 {
            opp-hz = <0x0 0x5FD82200>;
            opp-microvolt = <0x10C8E0 0x10C8E0 0x1312D0>;
            opp-microvolt-L0 = <0x10C8E0 0x10C8E0 0x1312D0>;
            opp-microvolt-L1 = <0x106738 0x106738 0x1312D0>;
            opp-microvolt-L2 = <0x100590 0x100590 0x1312D0>;
            opp-microvolt-L3 = <0xFA3E8 0xFA3E8 0x1312D0>;
            clock-latency-ns = <0x9C40>;
        };
        opp-1800000000 {
            opp-hz = <0x0 0x6B49D200>;
            opp-microvolt = <0x124F80 0x124F80 0x1312D0>;
            opp-microvolt-L0 = <0x124F80 0x124F80 0x1312D0>;
            opp-microvolt-L1 = <0x11EDD8 0x11EDD8 0x1312D0>;
            opp-microvolt-L2 = <0x118C30 0x118C30 0x1312D0>;
            opp-microvolt-L3 = <0x112A88 0x112A88 0x1312D0>;
            clock-latency-ns = <0x9C40>;
        };
    };
    opp-table2 {
        compatible = "operating-points-v2";
        rockchip,thermal-zone = "soc-thermal";
        rockchip,temp-hysteresis = <0x1388>;
        rockchip,low-temp = <0x2710>;
        rockchip,low-temp-min-volt = <0xDBBA0>;
        nvmem-cells = <0xD4>;
        nvmem-cell-names = "gpu_leakage";
        rockchip,pvtm-voltage-sel = <0x0 0x1D8A8 0x0 0x1D8A9 0x1EA3C 0x1 0x1EA3D 0x1F5F4 0x2 0x1F5F5 0xF423F 0x3>;
        rockchip,pvtm-freq = <0x30D40>;
        rockchip,pvtm-volt = <0xDBBA0>;
        rockchip,pvtm-ch = <0x3 0x0>;
        rockchip,pvtm-sample-time = <0x3E8>;
        rockchip,pvtm-number = <0xA>;
        rockchip,pvtm-error = <0x3E8>;
        rockchip,pvtm-ref-temp = <0x29>;
        rockchip,pvtm-temp-prop = <0x2E 0xC>;
        rockchip,pvtm-thermal-zone = "gpu-thermal";
        phandle = <0xA3>;
        opp-200000000 {
            opp-hz = <0x0 0xBEBC200>;
            opp-microvolt = <0xC96A8>;
            opp-microvolt-L0 = <0xC96A8>;
            opp-microvolt-L1 = <0xC96A8>;
            opp-microvolt-L2 = <0xC96A8>;
            opp-microvolt-L3 = <0xC96A8>;
        };
        opp-300000000 {
            opp-hz = <0x0 0x11E1A300>;
            opp-microvolt = <0xC96A8>;
            opp-microvolt-L0 = <0xC96A8>;
            opp-microvolt-L1 = <0xC96A8>;
            opp-microvolt-L2 = <0xC96A8>;
            opp-microvolt-L3 = <0xC96A8>;
        };
        opp-400000000 {
            opp-hz = <0x0 0x17D78400>;
            opp-microvolt = <0xC96A8>;
            opp-microvolt-L0 = <0xC96A8>;
            opp-microvolt-L1 = <0xC96A8>;
            opp-microvolt-L2 = <0xC96A8>;
            opp-microvolt-L3 = <0xC96A8>;
        };
        opp-600000000 {
            opp-hz = <0x0 0x23C34600>;
            opp-microvolt = <0xE1D48>;
            opp-microvolt-L0 = <0xE1D48>;
            opp-microvolt-L1 = <0xE1D48>;
            opp-microvolt-L2 = <0xDBBA0>;
            opp-microvolt-L3 = <0xDBBA0>;
        };
        opp-800000000 {
            opp-hz = <0x0 0x2FAF0800>;
            opp-microvolt = <0x10C8E0>;
            opp-microvolt-L0 = <0x10C8E0>;
            opp-microvolt-L1 = <0x106738>;
            opp-microvolt-L2 = <0x100590>;
            opp-microvolt-L3 = <0xFA3E8>;
        };
    };
    opp-table3 {
        compatible = "operating-points-v2";
        phandle = <0x95>;
        opp-200000000 {
            opp-hz = <0x0 0xBEBC200>;
            opp-microvolt = <0xDBBA0>;
            status = "disabled";
        };
        opp-300000000 {
            opp-hz = <0x0 0x11E1A300>;
            opp-microvolt = <0xDBBA0>;
            status = "disabled";
        };
        opp-400000000 {
            opp-hz = <0x0 0x17D78400>;
            opp-microvolt = <0xDBBA0>;
            status = "disabled";
        };
        opp-528000000 {
            opp-hz = <0x0 0x1F78A400>;
            opp-microvolt = <0xDBBA0>;
            status = "disabled";
        };
        opp-600000000 {
            opp-hz = <0x0 0x23C34600>;
            opp-microvolt = <0xDBBA0>;
            status = "disabled";
        };
        opp-800000000 {
            opp-hz = <0x0 0x2FAF0800>;
            opp-microvolt = <0xDBBA0>;
            status = "disabled";
        };
        opp-416000000 {
            opp-hz = <0x0 0x18CBA800>;
            opp-microvolt = <0xDBBA0>;
        };
        opp-856000000 {
            opp-hz = <0x0 0x33058600>;
            opp-microvolt = <0xDBBA0>;
        };
        opp-928000000 {
            opp-hz = <0x0 0x37502800>;
            opp-microvolt = <0xDBBA0>;
            status = "disabled";
        };
        opp-1056000000 {
            opp-hz = <0x0 0x3EF14800>;
            opp-microvolt = <0xDBBA0>;
            status = "disabled";
        };
    };
    hall-mh248 {
        compatible = "hall-mh248";
        pinctrl-names = "default";
        pinctrl-0 = <0xD5>;
        irq-gpio = <0x33 0x2 0x3>;
        hall-active = <0x1>;
        status = "disabled";
    };
    vcc-sys {
        compatible = "regulator-fixed";
        regulator-name = "vcc_sys";
        regulator-always-on;
        regulator-boot-on;
        regulator-min-microvolt = <0x3B8260>;
        regulator-max-microvolt = <0x3B8260>;
        phandle = <0x31>;
    };
    vcc3v3-sys {
        compatible = "regulator-fixed";
        regulator-name = "vcc3v3_sys";
        regulator-always-on;
        regulator-boot-on;
        regulator-min-microvolt = <0x325AA0>;
        regulator-max-microvolt = <0x325AA0>;
        phandle = <0x37>;
    };
    vcc5v0-otg-host-regulator {
        compatible = "regulator-fixed";
        gpio = <0x52 0x7 0x0>;
        pinctrl-names = "default";
        pinctrl-0 = <0xD6>;
        regulator-name = "vcc5v0_otg_host";
        regulator-min-microvolt = <0x4C4B40>;
        regulator-max-microvolt = <0x4C4B40>;
        regulator-always-on;
        enable-active-high;
        phandle = <0x9E>;
    };
    vcc5v0-host-regulator {
        compatible = "regulator-fixed";
        gpio = <0x89 0x1A 0x0>;
        pinctrl-names = "default";
        pinctrl-0 = <0xD7>;
        regulator-name = "vcc5v0_host";
        regulator-min-microvolt = <0x4C4B40>;
        regulator-max-microvolt = <0x4C4B40>;
        regulator-always-on;
        enable-active-high;
        phandle = <0x9F>;
    };
    vdd-log {
        compatible = "pwm-regulator";
        pwms = <0xD8 0x0 0x61A8 0x1>;
        rockchip,pwm_id = <0x2>;
        rockchip,pwm_voltage = <0xDBBA0>;
        regulator-name = "vdd_log";
        regulator-min-microvolt = <0xB71B0>;
        regulator-max-microvolt = <0x149970>;
        regulator-always-on;
        regulator-boot-on;
    };
    backlight {
        compatible = "pwm-backlight";
        pwms = <0xD9 0x0 0x61A8 0x1>;
        brightness-levels = <0xFF 0xC8 0xC7 0xC6 0xC5 0xC5 0xC4 0xC3 0xC2 0xC1 0xC1 0xC0 0xBF 0xBE 0xBD 0xBD 0xBC 0xBB 0xBA 0xB9 0xB9 0xB8 0xB7 0xB6 0xB5 0xB5 0xB4 0xB3 0xB2 0xB1 0xB1 0xB0 0xAF 0xAE 0xAD 0xAD 0xAC 0xAB 0xAA 0xA9 0xA9 0xA8 0xA7 0xA6 0xA5 0xA5 0xA4 0xA3 0xA2 0xA1 0xA1 0xA0 0x9F 0x9E 0x9D 0x9D 0x9C 0x9B 0x9A 0x99 0x99 0x98 0x97 0x96 0x95 0x95 0x94 0x93 0x92 0x91 0x91 0x90 0x8F 0x8E 0x8D 0x8D 0x8C 0x8B 0x8A 0x89 0x89 0x88 0x87 0x86 0x85 0x85 0x84 0x83 0x82 0x81 0x81 0x80 0x7F 0x7E 0x7D 0x7D 0x7C 0x7B 0x7A 0x79 0x79 0x78 0x77 0x76 0x75 0x75 0x74 0x73 0x72 0x71 0x71 0x70 0x6F 0x6E 0x6D 0x6D 0x6C 0x6B 0x6A 0x69 0x69 0x68 0x67 0x66 0x65 0x65 0x64 0x63 0x62 0x61 0x61 0x60 0x5F 0x5E 0x5D 0x5D 0x5C 0x5B 0x5A 0x59 0x59 0x58 0x57 0x56 0x55 0x55 0x54 0x53 0x52 0x51 0x51 0x50 0x4F 0x4E 0x4D 0x4D 0x4C 0x4B 0x4A 0x49 0x49 0x48 0x47 0x46 0x45 0x45 0x44 0x43 0x42 0x41 0x41 0x40 0x3F 0x3E 0x3D 0x3D 0x3C 0x3B 0x3A 0x39 0x39 0x38 0x37 0x36 0x35 0x35 0x34 0x33 0x32 0x31 0x31 0x30 0x2F 0x2E 0x2D 0x2D 0x2C 0x2B 0x2A 0x29 0x29 0x28 0x27 0x26 0x25 0x25 0x24 0x23 0x22 0x21 0x21 0x20 0x1F 0x1E 0x1D 0x1D 0x1C 0x1B 0x1A 0x19 0x19 0x18 0x17 0x16 0x15 0x15 0x14 0x13 0x12 0x11 0x11 0x10 0xF 0xE 0xD 0xD 0xC 0xB 0xA 0x9 0x9 0x8 0x7 0x6 0x5 0x5 0x4 0x3 0x2 0x1 0x1 0x0 0x0 0x0 0x0 0x0>;
        default-brightness-level = <0xC8>;
        enable-gpios = <0x89 0x19 0x0>;
    };
    backlight1 {
        compatible = "pwm-backlight";
        pwms = <0xDA 0x0 0x61A8 0x1>;
        brightness-levels = <0xFF 0xC8 0xC7 0xC6 0xC5 0xC5 0xC4 0xC3 0xC2 0xC1 0xC1 0xC0 0xBF 0xBE 0xBD 0xBD 0xBC 0xBB 0xBA 0xB9 0xB9 0xB8 0xB7 0xB6 0xB5 0xB5 0xB4 0xB3 0xB2 0xB1 0xB1 0xB0 0xAF 0xAE 0xAD 0xAD 0xAC 0xAB 0xAA 0xA9 0xA9 0xA8 0xA7 0xA6 0xA5 0xA5 0xA4 0xA3 0xA2 0xA1 0xA1 0xA0 0x9F 0x9E 0x9D 0x9D 0x9C 0x9B 0x9A 0x99 0x99 0x98 0x97 0x96 0x95 0x95 0x94 0x93 0x92 0x91 0x91 0x90 0x8F 0x8E 0x8D 0x8D 0x8C 0x8B 0x8A 0x89 0x89 0x88 0x87 0x86 0x85 0x85 0x84 0x83 0x82 0x81 0x81 0x80 0x7F 0x7E 0x7D 0x7D 0x7C 0x7B 0x7A 0x79 0x79 0x78 0x77 0x76 0x75 0x75 0x74 0x73 0x72 0x71 0x71 0x70 0x6F 0x6E 0x6D 0x6D 0x6C 0x6B 0x6A 0x69 0x69 0x68 0x67 0x66 0x65 0x65 0x64 0x63 0x62 0x61 0x61 0x60 0x5F 0x5E 0x5D 0x5D 0x5C 0x5B 0x5A 0x59 0x59 0x58 0x57 0x56 0x55 0x55 0x54 0x53 0x52 0x51 0x51 0x50 0x4F 0x4E 0x4D 0x4D 0x4C 0x4B 0x4A 0x49 0x49 0x48 0x47 0x46 0x45 0x45 0x44 0x43 0x42 0x41 0x41 0x40 0x3F 0x3E 0x3D 0x3D 0x3C 0x3B 0x3A 0x39 0x39 0x38 0x37 0x36 0x35 0x35 0x34 0x33 0x32 0x31 0x31 0x30 0x2F 0x2E 0x2D 0x2D 0x2C 0x2B 0x2A 0x29 0x29 0x28 0x27 0x26 0x25 0x25 0x24 0x23 0x22 0x21 0x21 0x20 0x1F 0x1E 0x1D 0x1D 0x1C 0x1B 0x1A 0x19 0x19 0x18 0x17 0x16 0x15 0x15 0x14 0x13 0x12 0x11 0x11 0x10 0xF 0xE 0xD 0xD 0xC 0xB 0xA 0x9 0x9 0x8 0x7 0x6 0x5 0x5 0x4 0x3 0x2 0x1 0x1 0x0 0x0 0x0 0x0 0x0>;
        default-brightness-level = <0xC8>;
    };
    vcc-phy-regulator {
        compatible = "regulator-fixed";
        regulator-name = "vcc_phy";
        regulator-always-on;
        regulator-boot-on;
        phandle = <0x17>;
    };
    rt5651-sound {
        status = "okay";
        compatible = "simple-audio-card";
        simple-audio-card,format = "i2s";
        simple-audio-card,name = "realtek,rt5651-codec";
        simple-audio-card,mclk-fs = <0x100>;
        simple-audio-card,widgets = "Microphone", "Mic Jack", "Headphone", "Headphone Jack";
        simple-audio-card,routing = "Mic Jack", "MICBIAS1", "IN1P", "Mic Jack", "Headphone Jack", "HPOL", "Headphone Jack", "HPOR";
        simple-audio-card,cpu {
            sound-dai = <0xDB>;
        };
        simple-audio-card,codec {
            sound-dai = <0xDC>;
        };
    };
    es8316-sound {
        status = "okay";
        compatible = "simple-audio-card";
        simple-audio-card,format = "i2s";
        simple-audio-card,name = "rockchip,es8316-codec";
        simple-audio-card,mclk-fs = <0x100>;
        simple-audio-card,widgets = "Microphone", "Mic Jack", "Headphone", "Headphone Jack";
        simple-audio-card,routing = "Mic Jack", "MICBIAS1", "IN1P", "Mic Jack", "Headphone Jack", "HPOL", "Headphone Jack", "HPOR";
        simple-audio-card,cpu {
            sound-dai = <0xDB>;
        };
        simple-audio-card,codec {
            sound-dai = <0xDD>;
        };
    };
    spdif-sound {
        status = "disabled";
        compatible = "simple-audio-card";
        simple-audio-card,name = "rockchip,spdif";
        simple-audio-card,cpu {
            sound-dai = <0xDE>;
        };
        simple-audio-card,codec {
            sound-dai = <0xDF>;
        };
    };
    spdif-out {
        compatible = "linux,spdif-dit";
        #sound-dai-cells = <0x0>;
        phandle = <0xDF>;
    };
    hdmi-codec {
        compatible = "simple-audio-card";
        simple-audio-card,format = "i2s";
        simple-audio-card,mclk-fs = <0x100>;
        simple-audio-card,name = "rockchip,hdmi";
        simple-audio-card,cpu {
            sound-dai = <0xE0>;
        };
        simple-audio-card,codec {
            sound-dai = <0xE1>;
        };
    };
    rk_headset {
        compatible = "rockchip_headset";
        headset_gpio = <0x89 0x1C 0x1>;
        pinctrl-names = "default";
        pinctrl-0 = <0xE2>;
        io-channels = <0xCB 0x2>;
    };
    sdio-pwrseq {
        compatible = "mmc-pwrseq-simple";
        clocks = <0xE3 0x1>;
        clock-names = "ext_clock";
        pinctrl-names = "default";
        pinctrl-0 = <0xE4>;
        reset-gpios = <0x3C 0xA 0x1>;
        phandle = <0x1B>;
    };
    wireless-wlan {
        compatible = "wlan-platdata";
        rockchip,grf = <0x15>;
        wifi_chip_type = "ap6354";
        sdio_vref = <0x708>;
        WIFI,host_wake_irq = <0x3C 0x3 0x0>;
        status = "okay";
    };
    wireless-bluetooth {
        compatible = "bluetooth-platdata";
        clocks = <0xE3 0x1>;
        clock-names = "ext_clock";
        uart_rts_gpios = <0x52 0x13 0x1>;
        pinctrl-names = "default", "rts_gpio";
        pinctrl-0 = <0xE5>;
        pinctrl-1 = <0xE6>;
        BT,reset_gpio = <0x3C 0x9 0x0>;
        BT,wake_gpio = <0x52 0x1A 0x0>;
        BT,wake_host_irq = <0x3C 0x4 0x0>;
        status = "okay";
    };
    vibrator {
        compatible = "rk-vibrator-gpio";
        vibrator-gpio = <0x89 0x1E 0x1>;
        status = "okay";
    };
    external-gmac-clock {
        compatible = "fixed-clock";
        clock-frequency = <0x2FAF080>;
        clock-output-names = "clkin_gmac";
        #clock-cells = <0x0>;
        phandle = <0x19>;
    };
    power-led {
        compatible = "gpio-leds";
        pinctrl-names = "default";
        pinctrl-0 = <0xE7>;
        standby {
            gpios = <0x52 0x5 0x0>;
            linux,default-trigger = "backlight";
            default-state = "on";
        };
        work {
            gpios = <0x89 0x1D 0x0>;
            linux,default-trigger = "timer";
            default-state = "on";
        };
        rild_power {
            gpios = <0x89 0x15 0x0>;
            default-state = "on";
        };
        rild_wakeup_out {
            gpios = <0x3C 0x2 0x1>;
            default-state = "on";
        };
        rild_disable {
            gpios = <0x3C 0x8 0x1>;
            default-state = "on";
        };
        rild_reg_on {
            gpios = <0x3C 0xC 0x0>;
            default-state = "on";
        };
        rild_lcc {
            gpios = <0x18 0x10 0x0>;
            default-state = "on";
        };
        rild_lcc_vbus {
            gpios = <0x33 0x4 0x0>;
            default-state = "on";
        };
        fan_power {
            gpios = <0x89 0x1B 0x0>;
            default-state = "on";
        };
        uart4_power {
            gpios = <0x52 0x4 0x0>;
            default-state = "on";
        };
    };
};
